SECTIONS
{
    HIDDEN(__romPos = 0);
    main_ROM_START = __romPos;
    main_VRAM = ADDR(.main);
    .main 0x8004BA20 : AT(main_ROM_START) SUBALIGN(4)
    {
        FILL(0x00000000);
        main_TEXT_START = .;
        build/main/asm/main/main/entry.s.o(.text);
        build/main/asm/main/main/func_8004D138.s.o(.text);
        build/main/asm/main/main/func_8004D1C8.s.o(.text);
        build/main/asm/main/main/func_8004D4B0.s.o(.text);
        build/main/asm/main/main/func_8004D504.s.o(.text);
        build/main/asm/main/main/func_8004D550.s.o(.text);
        build/main/asm/main/main/func_8004D5B4.s.o(.text);
        build/main/asm/main/main/func_8004D618.s.o(.text);
        build/main/asm/main/main/func_8004D65C.s.o(.text);
        build/main/asm/main/main/func_8004D7A0.s.o(.text);
        build/main/asm/main/main/func_8004D808.s.o(.text);
        build/main/asm/main/main/func_8004DC24.s.o(.text);
        build/main/asm/main/main/func_8004E094.s.o(.text);
        build/main/asm/main/main/func_8004E0F8.s.o(.text);
        build/main/asm/main/main/func_8004E1B8.s.o(.text);
        build/main/asm/main/main/func_8004E21C.s.o(.text);
        build/main/asm/main/main/func_8004E4E4.s.o(.text);
        build/main/asm/main/main/func_8004E594.s.o(.text);
        build/main/asm/main/main/func_8004E5F0.s.o(.text);
        build/main/asm/main/main/func_8004E670.s.o(.text);
        build/main/asm/main/main/func_8004E6C8.s.o(.text);
        build/main/asm/main/main/func_8004E6F4.s.o(.text);
        build/main/asm/main/main/func_8004E76C.s.o(.text);
        build/main/asm/main/main/func_8004E7A8.s.o(.text);
        build/main/asm/main/main/func_8004EC54.s.o(.text);
        build/main/asm/main/main/func_8004EC88.s.o(.text);
        build/main/asm/main/main/func_8004EE64.s.o(.text);
        build/main/src/main/main/func_8004EF5C.c.o(.text);
        build/main/asm/main/main/func_8004EF78.s.o(.text);
        build/main/asm/main/main/func_8004EFFC.s.o(.text);
        build/main/asm/main/main/func_8004F31C.s.o(.text);
        build/main/asm/main/main/func_8004F3B8.s.o(.text);
        build/main/asm/main/main/func_8004F440.s.o(.text);
        build/main/asm/main/main/func_8004F4AC.s.o(.text);
        build/main/asm/main/main/func_8004FCF8.s.o(.text);
        build/main/asm/main/main/func_80050260.s.o(.text);
        build/main/src/main/main/func_800502B8.c.o(.text);
        build/main/src/main/main/func_800502D4.c.o(.text);
        build/main/asm/main/main/func_800502F4.s.o(.text);
        build/main/asm/main/main/func_80050408.s.o(.text);
        build/main/asm/main/main/func_800521BC.s.o(.text);
        build/main/asm/main/main/func_8005252C.s.o(.text);
        build/main/asm/main/main/func_80052BB0.s.o(.text);
        build/main/asm/main/main/func_80052F5C.s.o(.text);
        build/main/asm/main/main/func_80053F00.s.o(.text);
        build/main/asm/main/main/func_800541C0.s.o(.text);
        build/main/asm/main/main/func_800555D8.s.o(.text);
        build/main/asm/main/main/func_8005566C.s.o(.text);
        build/main/asm/main/main/func_80056424.s.o(.text);
        build/main/asm/main/main/func_8005685C.s.o(.text);
        build/main/asm/main/main/func_800568F4.s.o(.text);
        build/main/asm/main/main/func_8005698C.s.o(.text);
        build/main/asm/main/main/func_80056A18.s.o(.text);
        build/main/asm/main/main/func_80056DE0.s.o(.text);
        build/main/asm/main/main/func_80056EAC.s.o(.text);
        build/main/asm/main/main/func_800577A8.s.o(.text);
        build/main/asm/main/main/func_80057A94.s.o(.text);
        build/main/asm/main/main/func_80057AC4.s.o(.text);
        build/main/asm/main/main/func_80057DB4.s.o(.text);
        build/main/asm/main/main/func_80058138.s.o(.text);
        build/main/asm/main/main/func_80058294.s.o(.text);
        build/main/asm/main/main/func_80058584.s.o(.text);
        build/main/asm/main/main/func_800586CC.s.o(.text);
        build/main/asm/main/main/func_8005A978.s.o(.text);
        build/main/asm/main/main/func_8005AA64.s.o(.text);
        build/main/asm/main/main/func_8005AA98.s.o(.text);
        build/main/asm/main/main/func_8005AB30.s.o(.text);
        build/main/asm/main/main/func_8005AB80.s.o(.text);
        build/main/asm/main/main/func_8005AC70.s.o(.text);
        build/main/asm/main/main/func_8005AFC4.s.o(.text);
        build/main/asm/main/main/func_8005B224.s.o(.text);
        build/main/asm/main/main/func_8005B7D8.s.o(.text);
        build/main/asm/main/main/func_8005B874.s.o(.text);
        build/main/src/main/main/func_8005BDB4.c.o(.text);
        build/main/asm/main/main/func_8005BDD0.s.o(.text);
        build/main/asm/main/main/func_8005BDF0.s.o(.text);
        build/main/asm/main/main/func_8005BF64.s.o(.text);
        build/main/asm/main/main/func_8005C010.s.o(.text);
        build/main/asm/main/main/func_8005C0BC.s.o(.text);
        build/main/asm/main/main/func_8005C540.s.o(.text);
        build/main/asm/main/main/func_8005C688.s.o(.text);
        build/main/asm/main/main/func_8005C8B8.s.o(.text);
        build/main/asm/main/main/func_8005C9BC.s.o(.text);
        build/main/asm/main/main/func_8005D0C8.s.o(.text);
        build/main/asm/main/main/func_8005D178.s.o(.text);
        build/main/asm/main/main/func_8005D9C0.s.o(.text);
        build/main/asm/main/main/func_8005DED4.s.o(.text);
        build/main/asm/main/main/func_8005DF20.s.o(.text);
        build/main/asm/main/main/func_8005DFAC.s.o(.text);
        build/main/asm/main/main/func_8005E004.s.o(.text);
        build/main/asm/main/main/func_8005E04C.s.o(.text);
        build/main/asm/main/main/func_8005E09C.s.o(.text);
        build/main/asm/main/main/func_8005E1B4.s.o(.text);
        build/main/asm/main/main/func_8005E2E4.s.o(.text);
        build/main/asm/main/main/func_8005E544.s.o(.text);
        build/main/asm/main/main/func_8005E5A4.s.o(.text);
        build/main/asm/main/main/func_8005E8B4.s.o(.text);
        build/main/asm/main/main/func_8005F530.s.o(.text);
        build/main/asm/main/main/func_8005F5B0.s.o(.text);
        build/main/asm/main/main/func_8005F6B8.s.o(.text);
        build/main/asm/main/main/func_8005F838.s.o(.text);
        build/main/asm/main/main/func_8005F980.s.o(.text);
        build/main/asm/main/main/func_8005FC3C.s.o(.text);
        build/main/asm/main/main/func_8005FCC0.s.o(.text);
        build/main/asm/main/main/func_8005FF44.s.o(.text);
        build/main/asm/main/main/func_800600D8.s.o(.text);
        build/main/asm/main/main/func_800602A0.s.o(.text);
        build/main/asm/main/main/func_80060834.s.o(.text);
        build/main/asm/main/main/func_80060960.s.o(.text);
        build/main/asm/main/main/func_80060B9C.s.o(.text);
        build/main/asm/main/main/func_80060DD8.s.o(.text);
        build/main/asm/main/main/func_8006114C.s.o(.text);
        build/main/asm/main/main/func_80061800.s.o(.text);
        build/main/asm/main/main/func_80061894.s.o(.text);
        build/main/asm/main/main/func_80061C70.s.o(.text);
        build/main/asm/main/main/func_80061CF0.s.o(.text);
        build/main/asm/main/main/func_80061EA4.s.o(.text);
        build/main/asm/main/main/func_80061EC8.s.o(.text);
        build/main/asm/main/main/func_80061EE8.s.o(.text);
        build/main/asm/main/main/func_80061F0C.s.o(.text);
        build/main/asm/main/main/func_80061FB4.s.o(.text);
        build/main/asm/main/main/func_800621C0.s.o(.text);
        build/main/asm/main/main/func_800625C8.s.o(.text);
        build/main/asm/main/main/func_80062878.s.o(.text);
        build/main/asm/main/main/func_80062B0C.s.o(.text);
        build/main/asm/main/main/func_80062CE8.s.o(.text);
        build/main/asm/main/main/func_80062D98.s.o(.text);
        build/main/asm/main/main/func_80063158.s.o(.text);
        build/main/asm/main/main/func_800634DC.s.o(.text);
        build/main/asm/main/main/func_80063650.s.o(.text);
        build/main/asm/main/main/func_80063A3C.s.o(.text);
        build/main/asm/main/main/func_80063B14.s.o(.text);
        build/main/asm/main/main/func_80063B9C.s.o(.text);
        build/main/asm/main/main/func_80063C08.s.o(.text);
        build/main/asm/main/main/func_80063CD8.s.o(.text);
        build/main/asm/main/main/func_80063DF0.s.o(.text);
        build/main/asm/main/main/func_80063F7C.s.o(.text);
        build/main/asm/main/main/func_8006421C.s.o(.text);
        build/main/asm/main/main/func_80065224.s.o(.text);
        build/main/asm/main/main/func_80065274.s.o(.text);
        build/main/asm/main/main/func_800652D8.s.o(.text);
        build/main/asm/main/main/func_80065370.s.o(.text);
        build/main/asm/main/main/func_80065424.s.o(.text);
        build/main/asm/main/main/func_80065560.s.o(.text);
        build/main/asm/main/main/func_80065648.s.o(.text);
        build/main/asm/main/main/func_8006584C.s.o(.text);
        build/main/asm/main/main/func_80065964.s.o(.text);
        build/main/asm/main/main/func_80065BDC.s.o(.text);
        build/main/asm/main/main/func_800661AC.s.o(.text);
        build/main/asm/main/main/func_80066400.s.o(.text);
        build/main/asm/main/main/func_80066580.s.o(.text);
        build/main/asm/main/main/func_80066C44.s.o(.text);
        build/main/asm/main/main/func_800676DC.s.o(.text);
        build/main/asm/main/main/func_80067DB4.s.o(.text);
        build/main/asm/main/main/func_80068D2C.s.o(.text);
        build/main/asm/main/main/func_800693BC.s.o(.text);
        build/main/asm/main/main/func_80069A60.s.o(.text);
        build/main/asm/main/main/func_8006AE78.s.o(.text);
        build/main/asm/main/main/func_8006C128.s.o(.text);
        build/main/asm/main/main/func_8006CD8C.s.o(.text);
        build/main/asm/main/main/func_8006CE9C.s.o(.text);
        build/main/asm/main/main/func_8006CF98.s.o(.text);
        build/main/asm/main/main/func_8006D1FC.s.o(.text);
        build/main/asm/main/main/func_800701C8.s.o(.text);
        build/main/asm/main/main/func_80070454.s.o(.text);
        build/main/asm/main/main/func_800705F0.s.o(.text);
        build/main/asm/main/main/func_800707B0.s.o(.text);
        build/main/asm/main/main/func_80070B0C.s.o(.text);
        build/main/asm/main/main/func_80070B24.s.o(.text);
        build/main/asm/main/main/func_80070BCC.s.o(.text);
        build/main/asm/main/main/func_80070C3C.s.o(.text);
        build/main/asm/main/main/func_80070C88.s.o(.text);
        build/main/asm/main/main/func_80070CD4.s.o(.text);
        build/main/asm/main/main/func_80070D50.s.o(.text);
        build/main/asm/main/main/func_80070DC4.s.o(.text);
        build/main/asm/main/main/func_80070E40.s.o(.text);
        build/main/asm/main/main/func_80070F50.s.o(.text);
        build/main/asm/main/main/func_80071108.s.o(.text);
        build/main/asm/main/main/func_80071360.s.o(.text);
        build/main/asm/main/main/func_80071408.s.o(.text);
        build/main/asm/main/main/func_800716E4.s.o(.text);
        build/main/asm/main/main/func_80071A28.s.o(.text);
        build/main/asm/main/main/func_80071D04.s.o(.text);
        build/main/asm/main/main/func_80071EA4.s.o(.text);
        build/main/asm/main/main/func_800721A8.s.o(.text);
        build/main/asm/main/main/func_80072340.s.o(.text);
        build/main/asm/main/main/func_80072550.s.o(.text);
        build/main/asm/main/main/func_800727EC.s.o(.text);
        build/main/asm/main/main/func_80072AD4.s.o(.text);
        build/main/asm/main/main/func_80072E00.s.o(.text);
        build/main/asm/main/main/func_80073480.s.o(.text);
        build/main/asm/main/main/func_80074E30.s.o(.text);
        build/main/asm/main/main/func_80074E6C.s.o(.text);
        build/main/asm/main/main/func_80074EA0.s.o(.text);
        build/main/asm/main/main/func_80074ED8.s.o(.text);
        build/main/asm/main/main/func_80074FC4.s.o(.text);
        build/main/asm/main/main/func_80075004.s.o(.text);
        build/main/asm/main/main/func_80075044.s.o(.text);
        build/main/asm/main/main/func_8007515C.s.o(.text);
        build/main/asm/main/main/func_80075270.s.o(.text);
        build/main/asm/main/main/func_800752E8.s.o(.text);
        build/main/asm/main/main/func_80075360.s.o(.text);
        build/main/asm/main/main/func_8007544C.s.o(.text);
        build/main/asm/main/main/func_80075518.s.o(.text);
        build/main/asm/main/main/func_8007558C.s.o(.text);
        build/main/asm/main/main/func_8007573C.s.o(.text);
        build/main/asm/main/main/func_8007583C.s.o(.text);
        build/main/asm/main/main/func_80075908.s.o(.text);
        build/main/asm/main/main/func_80075B78.s.o(.text);
        build/main/asm/main/main/func_80075C30.s.o(.text);
        build/main/asm/main/main/func_80075C7C.s.o(.text);
        build/main/asm/main/main/func_80075D0C.s.o(.text);
        build/main/asm/main/main/func_80075D9C.s.o(.text);
        build/main/asm/main/main/func_80075E04.s.o(.text);
        build/main/asm/main/main/func_80075EC8.s.o(.text);
        build/main/asm/main/main/func_80075F90.s.o(.text);
        build/main/asm/main/main/func_80076344.s.o(.text);
        build/main/asm/main/main/func_80079F28.s.o(.text);
        build/main/asm/main/main/func_80079F58.s.o(.text);
        build/main/asm/main/main/func_8007A210.s.o(.text);
        build/main/asm/main/main/func_8007A298.s.o(.text);
        build/main/asm/main/main/func_8007A6D8.s.o(.text);
        build/main/src/main/main/func_8007A8E0.c.o(.text);
        build/main/asm/main/main/func_8007A918.s.o(.text);
        build/main/asm/main/main/func_8007AA68.s.o(.text);
        build/main/asm/main/main/func_8007ABD8.s.o(.text);
        build/main/src/main/main/func_8007AC38.c.o(.text);
        build/main/asm/main/main/func_8007AC98.s.o(.text);
        build/main/asm/main/main/func_8007AD28.s.o(.text);
        build/main/asm/main/main/func_8007AE7C.s.o(.text);
        build/main/asm/main/main/func_8007AEE8.s.o(.text);
        build/main/asm/main/main/func_8007B118.s.o(.text);
        build/main/asm/main/main/func_8007B178.s.o(.text);
        build/main/asm/main/main/func_8007B318.s.o(.text);
        build/main/asm/main/main/func_8007B380.s.o(.text);
        build/main/asm/main/main/func_8007B4C0.s.o(.text);
        build/main/asm/main/main/func_8007B508.s.o(.text);
        build/main/asm/main/main/func_8007B568.s.o(.text);
        build/main/src/main/main/func_8007B7D8.c.o(.text);
        build/main/asm/main/main/func_8007B820.s.o(.text);
        build/main/asm/main/main/func_8007B890.s.o(.text);
        build/main/asm/main/main/func_8007BA28.s.o(.text);
        build/main/asm/main/main/func_8007BD08_merged.s.o(.text);
        build/main/asm/main/main/func_8007C848.s.o(.text);
        build/main/asm/main/main/func_8007C948.s.o(.text);
        build/main/asm/main/main/func_8007C9E8.s.o(.text);
        build/main/asm/main/main/func_8007CD08.s.o(.text);
        build/main/asm/main/main/func_8007CE48.s.o(.text);
        build/main/asm/main/main/func_8007CF98.s.o(.text);
        build/main/asm/main/main/func_8007D008.s.o(.text);
        build/main/asm/main/main/func_8007D0E8.s.o(.text);
        build/main/asm/main/main/func_8007D240.s.o(.text);
        build/main/asm/main/main/func_8007D30C.s.o(.text);
        build/main/asm/main/main/func_8007D47C.s.o(.text);
        build/main/asm/main/main/func_8007D4F0.s.o(.text);
        build/main/asm/main/main/func_8007D688.s.o(.text);
        build/main/asm/main/main/func_8007D8CC.s.o(.text);
        build/main/asm/main/main/func_8007DA74.s.o(.text);
        build/main/asm/main/main/func_8007DAB0.s.o(.text);
        build/main/asm/main/main/func_8007DD1C.s.o(.text);
        build/main/asm/main/main/func_8007DD7C.s.o(.text);
        build/main/asm/main/main/func_8007E074.s.o(.text);
        build/main/asm/main/main/func_8007E188.s.o(.text);
        build/main/src/main/main/func_8007E5E8.c.o(.text);
        build/main/asm/main/main/func_8007E618.s.o(.text);
        build/main/asm/main/main/func_8007E6C4.s.o(.text);
        build/main/asm/main/main/func_8007E734.s.o(.text);
        build/main/asm/main/main/func_8007E858.s.o(.text);
        build/main/asm/main/main/func_8007E8E4.s.o(.text);
        build/main/asm/main/main/func_8007E9D8.s.o(.text);
        build/main/asm/main/main/func_8007EA18.s.o(.text);
        build/main/asm/main/main/func_8007EA68.s.o(.text);
        build/main/asm/main/main/func_8007EAA8.s.o(.text);
        build/main/src/main/main/func_8007EAE8.c.o(.text);
        build/main/asm/main/main/func_8007EB18.s.o(.text);
        build/main/asm/main/main/func_8007EBC4.s.o(.text);
        build/main/asm/main/main/func_8007ED94.s.o(.text);
        build/main/asm/main/main/func_8007F5C4.s.o(.text);
        build/main/asm/main/main/func_8007FBD8.s.o(.text);
        build/main/asm/main/main/func_8007FE7C.s.o(.text);
        build/main/asm/main/main/func_8007FFE4.s.o(.text);
        build/main/asm/main/main/func_80080110.s.o(.text);
        build/main/asm/main/main/func_80080228.s.o(.text);
        build/main/asm/main/main/func_800805A4.s.o(.text);
        build/main/asm/main/main/func_80080DC4.s.o(.text);
        build/main/asm/main/main/func_800813E8.s.o(.text);
        build/main/asm/main/main/func_800814EC.s.o(.text);
        build/main/asm/main/main/func_8008155C.s.o(.text);
        build/main/asm/main/main/func_8008177C.s.o(.text);
        build/main/asm/main/main/func_80081900.s.o(.text);
        build/main/asm/main/main/func_80081B58.s.o(.text);
        build/main/asm/main/main/func_80081C30.s.o(.text);
        build/main/asm/main/main/func_80081D08.s.o(.text);
        build/main/asm/main/main/func_80081D94.s.o(.text);
        build/main/asm/main/main/func_800822DC.s.o(.text);
        build/main/asm/main/main/func_80082528.s.o(.text);
        build/main/asm/main/main/func_80082598.s.o(.text);
        build/main/asm/main/main/func_80082608.s.o(.text);
        build/main/asm/main/main/func_80082698.s.o(.text);
        build/main/asm/main/main/func_800826F8.s.o(.text);
        build/main/asm/main/main/func_80082758.s.o(.text);
        build/main/src/main/main/func_80082818.c.o(.text);
        build/main/asm/main/main/func_80082850.s.o(.text);
        build/main/asm/main/main/func_80082900.s.o(.text);
        build/main/asm/main/main/func_80082B98.s.o(.text);
        build/main/src/main/main/func_80082E98.c.o(.text);
        build/main/src/main/main/func_80082EDC.c.o(.text);
        build/main/src/main/main/func_80082F30.c.o(.text);
        build/main/asm/main/main/func_80082F84.s.o(.text);
        build/main/asm/main/main/func_8008300C.s.o(.text);
        build/main/asm/main/main/func_800830B4.s.o(.text);
        build/main/asm/main/main/func_800831F8.s.o(.text);
        build/main/asm/main/main/func_80083638.s.o(.text);
        build/main/asm/main/main/func_8008380C.s.o(.text);
        build/main/asm/main/main/func_80083BB8.s.o(.text);
        build/main/asm/main/main/func_80083CE4.s.o(.text);
        build/main/asm/main/main/func_800841B8.s.o(.text);
        build/main/src/main/main/func_800843AC.c.o(.text);
        build/main/asm/main/main/func_8008448C.s.o(.text);
        build/main/asm/main/main/func_8008465C.s.o(.text);
        build/main/asm/main/main/func_800849A4.s.o(.text);
        build/main/asm/main/main/func_80084F48.s.o(.text);
        build/main/asm/main/main/func_8008506C.s.o(.text);
        build/main/asm/main/main/func_80085154.s.o(.text);
        build/main/asm/main/main/func_80085410.s.o(.text);
        build/main/asm/main/main/func_800854C8.s.o(.text);
        build/main/asm/main/main/func_80085650.s.o(.text);
        build/main/asm/main/main/func_800857DC.s.o(.text);
        build/main/asm/main/main/func_80085A04.s.o(.text);
        build/main/asm/main/main/func_80085C74.s.o(.text);
        build/main/asm/main/main/func_80085FEC.s.o(.text);
        build/main/asm/main/main/func_80086088.s.o(.text);
        build/main/asm/main/main/func_800860D8.s.o(.text);
        build/main/asm/main/main/func_80086188.s.o(.text);
        build/main/asm/main/main/func_80086208.s.o(.text);
        build/main/asm/main/main/func_80086298.s.o(.text);
        build/main/asm/main/main/func_80086388.s.o(.text);
        build/main/asm/main/main/func_80086418.s.o(.text);
        build/main/asm/main/main/func_800864B8.s.o(.text);
        build/main/asm/main/main/func_80086558.s.o(.text);
        build/main/asm/main/main/func_800865F8.s.o(.text);
        build/main/asm/main/main/func_800866F4.s.o(.text);
        build/main/asm/main/main/func_80086848.s.o(.text);
        build/main/asm/main/main/func_80086904.s.o(.text);
        build/main/asm/main/main/func_80086928.s.o(.text);
        build/main/asm/main/main/func_80086A44.s.o(.text);
        build/main/asm/main/main/func_80086BD4.s.o(.text);
        build/main/asm/main/main/func_80086C20.s.o(.text);
        build/main/asm/main/main/func_80086C60.s.o(.text);
        build/main/asm/main/main/func_80086C98.s.o(.text);
        build/main/src/main/main/func_80086D28.c.o(.text);
        build/main/asm/main/main/func_80086D48.s.o(.text);
        build/main/asm/main/main/func_80086DE0.s.o(.text);
        build/main/asm/main/main/func_80086F60.s.o(.text);
        build/main/asm/main/main/func_80087158.s.o(.text);
        build/main/asm/main/main/func_800872A8.s.o(.text);
        build/main/asm/main/main/func_80087318.s.o(.text);
        build/main/asm/main/main/func_80087388.s.o(.text);
        build/main/asm/main/main/func_80087548.s.o(.text);
        build/main/asm/main/main/func_80087678.s.o(.text);
        build/main/asm/main/main/func_800876D8.s.o(.text);
        build/main/asm/main/main/func_80087728.s.o(.text);
        build/main/asm/main/main/func_80087A88.s.o(.text);
        build/main/asm/main/main/func_80087AF8.s.o(.text);
        build/main/asm/main/main/func_80087B50.s.o(.text);
        build/main/asm/main/main/func_80087B78.s.o(.text);
        build/main/asm/main/main/func_80087BC8.s.o(.text);
        build/main/asm/main/main/func_80087C4C.s.o(.text);
        build/main/asm/main/main/func_80087C78.s.o(.text);
        build/main/src/main/main/func_80087D28.c.o(.text);
        build/main/asm/main/main/func_80087D78.s.o(.text);
        build/main/asm/main/main/func_80087D80.s.o(.text);
        build/main/src/main/main/func_80087DBC.c.o(.text);
        build/main/asm/main/main/func_80087DE8.s.o(.text);
        build/main/asm/main/main/func_80087EB8.s.o(.text);
        build/main/asm/main/main/func_80087F54.s.o(.text);
        build/main/asm/main/main/func_80088048.s.o(.text);
        build/main/asm/main/main/func_80088248.s.o(.text);
        build/main/asm/main/main/func_80088310.s.o(.text);
        build/main/asm/main/main/func_80088408.s.o(.text);
        build/main/asm/main/main/func_800884E8.s.o(.text);
        build/main/asm/main/main/func_8008896C.s.o(.text);
        build/main/asm/main/main/func_80088BD0.s.o(.text);
        build/main/asm/main/main/func_80088C98.s.o(.text);
        build/main/asm/main/main/func_80088E9C.s.o(.text);
        build/main/asm/main/main/func_80089018.s.o(.text);
        build/main/asm/main/main/func_800890C8.s.o(.text);
        build/main/asm/main/main/func_80089198.s.o(.text);
        build/main/asm/main/main/func_800891F4.s.o(.text);
        build/main/asm/main/main/func_8008925C.s.o(.text);
        build/main/asm/main/main/func_80089674.s.o(.text);
        build/main/asm/main/main/func_8008980C.s.o(.text);
        build/main/asm/main/main/func_80089A68.s.o(.text);
        build/main/asm/main/main/func_80089B64.s.o(.text);
        build/main/asm/main/main/func_80089E84.s.o(.text);
        build/main/asm/main/main/func_80089EF8.s.o(.text);
        build/main/asm/main/main/func_8008A114.s.o(.text);
        build/main/asm/main/main/func_8008A288.s.o(.text);
        build/main/asm/main/main/func_8008A568.s.o(.text);
        build/main/asm/main/main/func_8008A7A0.s.o(.text);
        build/main/asm/main/main/func_8008A898.s.o(.text);
        build/main/asm/main/main/func_8008A994.s.o(.text);
        build/main/asm/main/main/func_8008AD98.s.o(.text);
        build/main/asm/main/main/func_8008B088.s.o(.text);
        build/main/asm/main/main/func_8008B248.s.o(.text);
        build/main/asm/main/main/func_8008B3E8.s.o(.text);
        build/main/asm/main/main/func_8008B4EC.s.o(.text);
        build/main/asm/main/main/func_8008B5B8.s.o(.text);
        build/main/asm/main/main/func_8008B708.s.o(.text);
        build/main/asm/main/main/func_8008B858.s.o(.text);
        build/main/asm/main/main/func_8008BAC8.s.o(.text);
        build/main/asm/main/main/func_8008C18C.s.o(.text);
        build/main/asm/main/main/func_8008C340.s.o(.text);
        build/main/asm/main/main/func_8008C528.s.o(.text);
        build/main/asm/main/main/func_8008C788.s.o(.text);
        build/main/asm/main/main/func_8008C898.s.o(.text);
        build/main/asm/main/main/func_8008CA00.s.o(.text);
        build/main/asm/main/main/func_8008CB6C.s.o(.text);
        build/main/asm/main/main/func_8008CCE8.s.o(.text);
        build/main/asm/main/main/func_8008CEC0.s.o(.text);
        build/main/asm/main/main/func_8008CF18.s.o(.text);
        build/main/asm/main/main/func_8008D0A8.s.o(.text);
        build/main/asm/main/main/func_8008D188.s.o(.text);
        build/main/asm/main/main/func_8008D3C0.s.o(.text);
        build/main/asm/main/main/func_8008D4EC.s.o(.text);
        build/main/asm/main/main/func_8008D5B0.s.o(.text);
        build/main/asm/main/main/func_8008DC54.s.o(.text);
        build/main/asm/main/main/func_8008DD34.s.o(.text);
        build/main/asm/main/main/func_8008DE28.s.o(.text);
        build/main/asm/main/main/func_8008E2B8.s.o(.text);
        build/main/asm/main/main/func_8008E318.s.o(.text);
        build/main/asm/main/main/func_8008E368.s.o(.text);
        build/main/asm/main/main/func_8008E3C0.s.o(.text);
        build/main/asm/main/main/func_8008E410.s.o(.text);
        build/main/src/main/main/func_8008E458.c.o(.text);
        build/main/asm/main/main/func_8008E4A8.s.o(.text);
        build/main/asm/main/main/func_8008E4B0.s.o(.text);
        build/main/src/main/main/func_8008E4EC.c.o(.text);
        build/main/asm/main/main/func_8008E518.s.o(.text);
        build/main/asm/main/main/func_8008E628.s.o(.text);
        build/main/asm/main/main/func_8008ED50.s.o(.text);
        build/main/src/main/main/func_8008EE18.c.o(.text);
        build/main/asm/main/main/func_8008EE3C.s.o(.text);
        build/main/asm/main/main/func_8008EF38.s.o(.text);
        build/main/asm/main/main/func_8008F5A8.s.o(.text);
        build/main/asm/main/main/func_8008FBF8.s.o(.text);
        build/main/asm/main/main/func_8008FE98.s.o(.text);
        build/main/asm/main/main/func_8008FFA0.s.o(.text);
        build/main/asm/main/main/func_80090028.s.o(.text);
        build/main/asm/main/main/func_80090598.s.o(.text);
        build/main/asm/main/main/func_80090AE8.s.o(.text);
        build/main/asm/main/main/func_80090C38.s.o(.text);
        . = ALIGN(., 4);
        main_TEXT_END = .;
        main_TEXT_SIZE = ABSOLUTE(main_TEXT_END - main_TEXT_START);
        main_DATA_START = .;
        build/main/asm/main/main/entry.s.o(.data);
        build/main/asm/main/main/func_8004D138.s.o(.data);
        build/main/asm/main/main/func_8004D1C8.s.o(.data);
        build/main/asm/main/main/func_8004D4B0.s.o(.data);
        build/main/asm/main/main/func_8004D504.s.o(.data);
        build/main/asm/main/main/func_8004D550.s.o(.data);
        build/main/asm/main/main/func_8004D5B4.s.o(.data);
        build/main/asm/main/main/func_8004D618.s.o(.data);
        build/main/asm/main/main/func_8004D65C.s.o(.data);
        build/main/asm/main/main/func_8004D7A0.s.o(.data);
        build/main/asm/main/main/func_8004D808.s.o(.data);
        build/main/asm/main/main/func_8004DC24.s.o(.data);
        build/main/asm/main/main/func_8004E094.s.o(.data);
        build/main/asm/main/main/func_8004E0F8.s.o(.data);
        build/main/asm/main/main/func_8004E1B8.s.o(.data);
        build/main/asm/main/main/func_8004E21C.s.o(.data);
        build/main/asm/main/main/func_8004E4E4.s.o(.data);
        build/main/asm/main/main/func_8004E594.s.o(.data);
        build/main/asm/main/main/func_8004E5F0.s.o(.data);
        build/main/asm/main/main/func_8004E670.s.o(.data);
        build/main/asm/main/main/func_8004E6C8.s.o(.data);
        build/main/asm/main/main/func_8004E6F4.s.o(.data);
        build/main/asm/main/main/func_8004E76C.s.o(.data);
        build/main/asm/main/main/func_8004E7A8.s.o(.data);
        build/main/asm/main/main/func_8004EC54.s.o(.data);
        build/main/asm/main/main/func_8004EC88.s.o(.data);
        build/main/asm/main/main/func_8004EE64.s.o(.data);
        build/main/src/main/main/func_8004EF5C.c.o(.data);
        build/main/asm/main/main/func_8004EF78.s.o(.data);
        build/main/asm/main/main/func_8004EFFC.s.o(.data);
        build/main/asm/main/main/func_8004F31C.s.o(.data);
        build/main/asm/main/main/func_8004F3B8.s.o(.data);
        build/main/asm/main/main/func_8004F440.s.o(.data);
        build/main/asm/main/main/func_8004F4AC.s.o(.data);
        build/main/asm/main/main/func_8004FCF8.s.o(.data);
        build/main/asm/main/main/func_80050260.s.o(.data);
        build/main/src/main/main/func_800502B8.c.o(.data);
        build/main/src/main/main/func_800502D4.c.o(.data);
        build/main/asm/main/main/func_800502F4.s.o(.data);
        build/main/asm/main/main/func_80050408.s.o(.data);
        build/main/asm/main/main/func_800521BC.s.o(.data);
        build/main/asm/main/main/func_8005252C.s.o(.data);
        build/main/asm/main/main/func_80052BB0.s.o(.data);
        build/main/asm/main/main/func_80052F5C.s.o(.data);
        build/main/asm/main/main/func_80053F00.s.o(.data);
        build/main/asm/main/main/func_800541C0.s.o(.data);
        build/main/asm/main/main/func_800555D8.s.o(.data);
        build/main/asm/main/main/func_8005566C.s.o(.data);
        build/main/asm/main/main/func_80056424.s.o(.data);
        build/main/asm/main/main/func_8005685C.s.o(.data);
        build/main/asm/main/main/func_800568F4.s.o(.data);
        build/main/asm/main/main/func_8005698C.s.o(.data);
        build/main/asm/main/main/func_80056A18.s.o(.data);
        build/main/asm/main/main/func_80056DE0.s.o(.data);
        build/main/asm/main/main/func_80056EAC.s.o(.data);
        build/main/asm/main/main/func_800577A8.s.o(.data);
        build/main/asm/main/main/func_80057A94.s.o(.data);
        build/main/asm/main/main/func_80057AC4.s.o(.data);
        build/main/asm/main/main/func_80057DB4.s.o(.data);
        build/main/asm/main/main/func_80058138.s.o(.data);
        build/main/asm/main/main/func_80058294.s.o(.data);
        build/main/asm/main/main/func_80058584.s.o(.data);
        build/main/asm/main/main/func_800586CC.s.o(.data);
        build/main/asm/main/main/func_8005A978.s.o(.data);
        build/main/asm/main/main/func_8005AA64.s.o(.data);
        build/main/asm/main/main/func_8005AA98.s.o(.data);
        build/main/asm/main/main/func_8005AB30.s.o(.data);
        build/main/asm/main/main/func_8005AB80.s.o(.data);
        build/main/asm/main/main/func_8005AC70.s.o(.data);
        build/main/asm/main/main/func_8005AFC4.s.o(.data);
        build/main/asm/main/main/func_8005B224.s.o(.data);
        build/main/asm/main/main/func_8005B7D8.s.o(.data);
        build/main/asm/main/main/func_8005B874.s.o(.data);
        build/main/src/main/main/func_8005BDB4.c.o(.data);
        build/main/asm/main/main/func_8005BDD0.s.o(.data);
        build/main/asm/main/main/func_8005BDF0.s.o(.data);
        build/main/asm/main/main/func_8005BF64.s.o(.data);
        build/main/asm/main/main/func_8005C010.s.o(.data);
        build/main/asm/main/main/func_8005C0BC.s.o(.data);
        build/main/asm/main/main/func_8005C540.s.o(.data);
        build/main/asm/main/main/func_8005C688.s.o(.data);
        build/main/asm/main/main/func_8005C8B8.s.o(.data);
        build/main/asm/main/main/func_8005C9BC.s.o(.data);
        build/main/asm/main/main/func_8005D0C8.s.o(.data);
        build/main/asm/main/main/func_8005D178.s.o(.data);
        build/main/asm/main/main/func_8005D9C0.s.o(.data);
        build/main/asm/main/main/func_8005DED4.s.o(.data);
        build/main/asm/main/main/func_8005DF20.s.o(.data);
        build/main/asm/main/main/func_8005DFAC.s.o(.data);
        build/main/asm/main/main/func_8005E004.s.o(.data);
        build/main/asm/main/main/func_8005E04C.s.o(.data);
        build/main/asm/main/main/func_8005E09C.s.o(.data);
        build/main/asm/main/main/func_8005E1B4.s.o(.data);
        build/main/asm/main/main/func_8005E2E4.s.o(.data);
        build/main/asm/main/main/func_8005E544.s.o(.data);
        build/main/asm/main/main/func_8005E5A4.s.o(.data);
        build/main/asm/main/main/func_8005E8B4.s.o(.data);
        build/main/asm/main/main/func_8005F530.s.o(.data);
        build/main/asm/main/main/func_8005F5B0.s.o(.data);
        build/main/asm/main/main/func_8005F6B8.s.o(.data);
        build/main/asm/main/main/func_8005F838.s.o(.data);
        build/main/asm/main/main/func_8005F980.s.o(.data);
        build/main/asm/main/main/func_8005FC3C.s.o(.data);
        build/main/asm/main/main/func_8005FCC0.s.o(.data);
        build/main/asm/main/main/func_8005FF44.s.o(.data);
        build/main/asm/main/main/func_800600D8.s.o(.data);
        build/main/asm/main/main/func_800602A0.s.o(.data);
        build/main/asm/main/main/func_80060834.s.o(.data);
        build/main/asm/main/main/func_80060960.s.o(.data);
        build/main/asm/main/main/func_80060B9C.s.o(.data);
        build/main/asm/main/main/func_80060DD8.s.o(.data);
        build/main/asm/main/main/func_8006114C.s.o(.data);
        build/main/asm/main/main/func_80061800.s.o(.data);
        build/main/asm/main/main/func_80061894.s.o(.data);
        build/main/asm/main/main/func_80061C70.s.o(.data);
        build/main/asm/main/main/func_80061CF0.s.o(.data);
        build/main/asm/main/main/func_80061EA4.s.o(.data);
        build/main/asm/main/main/func_80061EC8.s.o(.data);
        build/main/asm/main/main/func_80061EE8.s.o(.data);
        build/main/asm/main/main/func_80061F0C.s.o(.data);
        build/main/asm/main/main/func_80061FB4.s.o(.data);
        build/main/asm/main/main/func_800621C0.s.o(.data);
        build/main/asm/main/main/func_800625C8.s.o(.data);
        build/main/asm/main/main/func_80062878.s.o(.data);
        build/main/asm/main/main/func_80062B0C.s.o(.data);
        build/main/asm/main/main/func_80062CE8.s.o(.data);
        build/main/asm/main/main/func_80062D98.s.o(.data);
        build/main/asm/main/main/func_80063158.s.o(.data);
        build/main/asm/main/main/func_800634DC.s.o(.data);
        build/main/asm/main/main/func_80063650.s.o(.data);
        build/main/asm/main/main/func_80063A3C.s.o(.data);
        build/main/asm/main/main/func_80063B14.s.o(.data);
        build/main/asm/main/main/func_80063B9C.s.o(.data);
        build/main/asm/main/main/func_80063C08.s.o(.data);
        build/main/asm/main/main/func_80063CD8.s.o(.data);
        build/main/asm/main/main/func_80063DF0.s.o(.data);
        build/main/asm/main/main/func_80063F7C.s.o(.data);
        build/main/asm/main/main/func_8006421C.s.o(.data);
        build/main/asm/main/main/func_80065224.s.o(.data);
        build/main/asm/main/main/func_80065274.s.o(.data);
        build/main/asm/main/main/func_800652D8.s.o(.data);
        build/main/asm/main/main/func_80065370.s.o(.data);
        build/main/asm/main/main/func_80065424.s.o(.data);
        build/main/asm/main/main/func_80065560.s.o(.data);
        build/main/asm/main/main/func_80065648.s.o(.data);
        build/main/asm/main/main/func_8006584C.s.o(.data);
        build/main/asm/main/main/func_80065964.s.o(.data);
        build/main/asm/main/main/func_80065BDC.s.o(.data);
        build/main/asm/main/main/func_800661AC.s.o(.data);
        build/main/asm/main/main/func_80066400.s.o(.data);
        build/main/asm/main/main/func_80066580.s.o(.data);
        build/main/asm/main/main/func_80066C44.s.o(.data);
        build/main/asm/main/main/func_800676DC.s.o(.data);
        build/main/asm/main/main/func_80067DB4.s.o(.data);
        build/main/asm/main/main/func_80068D2C.s.o(.data);
        build/main/asm/main/main/func_800693BC.s.o(.data);
        build/main/asm/main/main/func_80069A60.s.o(.data);
        build/main/asm/main/main/func_8006AE78.s.o(.data);
        build/main/asm/main/main/func_8006C128.s.o(.data);
        build/main/asm/main/main/func_8006CD8C.s.o(.data);
        build/main/asm/main/main/func_8006CE9C.s.o(.data);
        build/main/asm/main/main/func_8006CF98.s.o(.data);
        build/main/asm/main/main/func_8006D1FC.s.o(.data);
        build/main/asm/main/main/func_800701C8.s.o(.data);
        build/main/asm/main/main/func_80070454.s.o(.data);
        build/main/asm/main/main/func_800705F0.s.o(.data);
        build/main/asm/main/main/func_800707B0.s.o(.data);
        build/main/asm/main/main/func_80070B0C.s.o(.data);
        build/main/asm/main/main/func_80070B24.s.o(.data);
        build/main/asm/main/main/func_80070BCC.s.o(.data);
        build/main/asm/main/main/func_80070C3C.s.o(.data);
        build/main/asm/main/main/func_80070C88.s.o(.data);
        build/main/asm/main/main/func_80070CD4.s.o(.data);
        build/main/asm/main/main/func_80070D50.s.o(.data);
        build/main/asm/main/main/func_80070DC4.s.o(.data);
        build/main/asm/main/main/func_80070E40.s.o(.data);
        build/main/asm/main/main/func_80070F50.s.o(.data);
        build/main/asm/main/main/func_80071108.s.o(.data);
        build/main/asm/main/main/func_80071360.s.o(.data);
        build/main/asm/main/main/func_80071408.s.o(.data);
        build/main/asm/main/main/func_800716E4.s.o(.data);
        build/main/asm/main/main/func_80071A28.s.o(.data);
        build/main/asm/main/main/func_80071D04.s.o(.data);
        build/main/asm/main/main/func_80071EA4.s.o(.data);
        build/main/asm/main/main/func_800721A8.s.o(.data);
        build/main/asm/main/main/func_80072340.s.o(.data);
        build/main/asm/main/main/func_80072550.s.o(.data);
        build/main/asm/main/main/func_800727EC.s.o(.data);
        build/main/asm/main/main/func_80072AD4.s.o(.data);
        build/main/asm/main/main/func_80072E00.s.o(.data);
        build/main/asm/main/main/func_80073480.s.o(.data);
        build/main/asm/main/main/func_80074E30.s.o(.data);
        build/main/asm/main/main/func_80074E6C.s.o(.data);
        build/main/asm/main/main/func_80074EA0.s.o(.data);
        build/main/asm/main/main/func_80074ED8.s.o(.data);
        build/main/asm/main/main/func_80074FC4.s.o(.data);
        build/main/asm/main/main/func_80075004.s.o(.data);
        build/main/asm/main/main/func_80075044.s.o(.data);
        build/main/asm/main/main/func_8007515C.s.o(.data);
        build/main/asm/main/main/func_80075270.s.o(.data);
        build/main/asm/main/main/func_800752E8.s.o(.data);
        build/main/asm/main/main/func_80075360.s.o(.data);
        build/main/asm/main/main/func_8007544C.s.o(.data);
        build/main/asm/main/main/func_80075518.s.o(.data);
        build/main/asm/main/main/func_8007558C.s.o(.data);
        build/main/asm/main/main/func_8007573C.s.o(.data);
        build/main/asm/main/main/func_8007583C.s.o(.data);
        build/main/asm/main/main/func_80075908.s.o(.data);
        build/main/asm/main/main/func_80075B78.s.o(.data);
        build/main/asm/main/main/func_80075C30.s.o(.data);
        build/main/asm/main/main/func_80075C7C.s.o(.data);
        build/main/asm/main/main/func_80075D0C.s.o(.data);
        build/main/asm/main/main/func_80075D9C.s.o(.data);
        build/main/asm/main/main/func_80075E04.s.o(.data);
        build/main/asm/main/main/func_80075EC8.s.o(.data);
        build/main/asm/main/main/func_80075F90.s.o(.data);
        build/main/asm/main/main/func_80076344.s.o(.data);
        build/main/asm/main/main/func_80079F28.s.o(.data);
        build/main/asm/main/main/func_80079F58.s.o(.data);
        build/main/asm/main/main/func_8007A210.s.o(.data);
        build/main/asm/main/main/func_8007A298.s.o(.data);
        build/main/asm/main/main/func_8007A6D8.s.o(.data);
        build/main/src/main/main/func_8007A8E0.c.o(.data);
        build/main/asm/main/main/func_8007A918.s.o(.data);
        build/main/asm/main/main/func_8007AA68.s.o(.data);
        build/main/asm/main/main/func_8007ABD8.s.o(.data);
        build/main/src/main/main/func_8007AC38.c.o(.data);
        build/main/asm/main/main/func_8007AC98.s.o(.data);
        build/main/asm/main/main/func_8007AD28.s.o(.data);
        build/main/asm/main/main/func_8007AE7C.s.o(.data);
        build/main/asm/main/main/func_8007AEE8.s.o(.data);
        build/main/asm/main/main/func_8007B118.s.o(.data);
        build/main/asm/main/main/func_8007B178.s.o(.data);
        build/main/asm/main/main/func_8007B318.s.o(.data);
        build/main/asm/main/main/func_8007B380.s.o(.data);
        build/main/asm/main/main/func_8007B4C0.s.o(.data);
        build/main/asm/main/main/func_8007B508.s.o(.data);
        build/main/asm/main/main/func_8007B568.s.o(.data);
        build/main/src/main/main/func_8007B7D8.c.o(.data);
        build/main/asm/main/main/func_8007B820.s.o(.data);
        build/main/asm/main/main/func_8007B890.s.o(.data);
        build/main/asm/main/main/func_8007BA28.s.o(.data);
        build/main/asm/main/main/func_8007BD08_merged.s.o(.data);
        build/main/asm/main/main/func_8007C848.s.o(.data);
        build/main/asm/main/main/func_8007C948.s.o(.data);
        build/main/asm/main/main/func_8007C9E8.s.o(.data);
        build/main/asm/main/main/func_8007CD08.s.o(.data);
        build/main/asm/main/main/func_8007CE48.s.o(.data);
        build/main/asm/main/main/func_8007CF98.s.o(.data);
        build/main/asm/main/main/func_8007D008.s.o(.data);
        build/main/asm/main/main/func_8007D0E8.s.o(.data);
        build/main/asm/main/main/func_8007D240.s.o(.data);
        build/main/asm/main/main/func_8007D30C.s.o(.data);
        build/main/asm/main/main/func_8007D47C.s.o(.data);
        build/main/asm/main/main/func_8007D4F0.s.o(.data);
        build/main/asm/main/main/func_8007D688.s.o(.data);
        build/main/asm/main/main/func_8007D8CC.s.o(.data);
        build/main/asm/main/main/func_8007DA74.s.o(.data);
        build/main/asm/main/main/func_8007DAB0.s.o(.data);
        build/main/asm/main/main/func_8007DD1C.s.o(.data);
        build/main/asm/main/main/func_8007DD7C.s.o(.data);
        build/main/asm/main/main/func_8007E074.s.o(.data);
        build/main/asm/main/main/func_8007E188.s.o(.data);
        build/main/src/main/main/func_8007E5E8.c.o(.data);
        build/main/asm/main/main/func_8007E618.s.o(.data);
        build/main/asm/main/main/func_8007E6C4.s.o(.data);
        build/main/asm/main/main/func_8007E734.s.o(.data);
        build/main/asm/main/main/func_8007E858.s.o(.data);
        build/main/asm/main/main/func_8007E8E4.s.o(.data);
        build/main/asm/main/main/func_8007E9D8.s.o(.data);
        build/main/asm/main/main/func_8007EA18.s.o(.data);
        build/main/asm/main/main/func_8007EA68.s.o(.data);
        build/main/asm/main/main/func_8007EAA8.s.o(.data);
        build/main/src/main/main/func_8007EAE8.c.o(.data);
        build/main/asm/main/main/func_8007EB18.s.o(.data);
        build/main/asm/main/main/func_8007EBC4.s.o(.data);
        build/main/asm/main/main/func_8007ED94.s.o(.data);
        build/main/asm/main/main/func_8007F5C4.s.o(.data);
        build/main/asm/main/main/func_8007FBD8.s.o(.data);
        build/main/asm/main/main/func_8007FE7C.s.o(.data);
        build/main/asm/main/main/func_8007FFE4.s.o(.data);
        build/main/asm/main/main/func_80080110.s.o(.data);
        build/main/asm/main/main/func_80080228.s.o(.data);
        build/main/asm/main/main/func_800805A4.s.o(.data);
        build/main/asm/main/main/func_80080DC4.s.o(.data);
        build/main/asm/main/main/func_800813E8.s.o(.data);
        build/main/asm/main/main/func_800814EC.s.o(.data);
        build/main/asm/main/main/func_8008155C.s.o(.data);
        build/main/asm/main/main/func_8008177C.s.o(.data);
        build/main/asm/main/main/func_80081900.s.o(.data);
        build/main/asm/main/main/func_80081B58.s.o(.data);
        build/main/asm/main/main/func_80081C30.s.o(.data);
        build/main/asm/main/main/func_80081D08.s.o(.data);
        build/main/asm/main/main/func_80081D94.s.o(.data);
        build/main/asm/main/main/func_800822DC.s.o(.data);
        build/main/asm/main/main/func_80082528.s.o(.data);
        build/main/asm/main/main/func_80082598.s.o(.data);
        build/main/asm/main/main/func_80082608.s.o(.data);
        build/main/asm/main/main/func_80082698.s.o(.data);
        build/main/asm/main/main/func_800826F8.s.o(.data);
        build/main/asm/main/main/func_80082758.s.o(.data);
        build/main/src/main/main/func_80082818.c.o(.data);
        build/main/asm/main/main/func_80082850.s.o(.data);
        build/main/asm/main/main/func_80082900.s.o(.data);
        build/main/asm/main/main/func_80082B98.s.o(.data);
        build/main/src/main/main/func_80082E98.c.o(.data);
        build/main/src/main/main/func_80082EDC.c.o(.data);
        build/main/src/main/main/func_80082F30.c.o(.data);
        build/main/asm/main/main/func_80082F84.s.o(.data);
        build/main/asm/main/main/func_8008300C.s.o(.data);
        build/main/asm/main/main/func_800830B4.s.o(.data);
        build/main/asm/main/main/func_800831F8.s.o(.data);
        build/main/asm/main/main/func_80083638.s.o(.data);
        build/main/asm/main/main/func_8008380C.s.o(.data);
        build/main/asm/main/main/func_80083BB8.s.o(.data);
        build/main/asm/main/main/func_80083CE4.s.o(.data);
        build/main/asm/main/main/func_800841B8.s.o(.data);
        build/main/src/main/main/func_800843AC.c.o(.data);
        build/main/asm/main/main/func_8008448C.s.o(.data);
        build/main/asm/main/main/func_8008465C.s.o(.data);
        build/main/asm/main/main/func_800849A4.s.o(.data);
        build/main/asm/main/main/func_80084F48.s.o(.data);
        build/main/asm/main/main/func_8008506C.s.o(.data);
        build/main/asm/main/main/func_80085154.s.o(.data);
        build/main/asm/main/main/func_80085410.s.o(.data);
        build/main/asm/main/main/func_800854C8.s.o(.data);
        build/main/asm/main/main/func_80085650.s.o(.data);
        build/main/asm/main/main/func_800857DC.s.o(.data);
        build/main/asm/main/main/func_80085A04.s.o(.data);
        build/main/asm/main/main/func_80085C74.s.o(.data);
        build/main/asm/main/main/func_80085FEC.s.o(.data);
        build/main/asm/main/main/func_80086088.s.o(.data);
        build/main/asm/main/main/func_800860D8.s.o(.data);
        build/main/asm/main/main/func_80086188.s.o(.data);
        build/main/asm/main/main/func_80086208.s.o(.data);
        build/main/asm/main/main/func_80086298.s.o(.data);
        build/main/asm/main/main/func_80086388.s.o(.data);
        build/main/asm/main/main/func_80086418.s.o(.data);
        build/main/asm/main/main/func_800864B8.s.o(.data);
        build/main/asm/main/main/func_80086558.s.o(.data);
        build/main/asm/main/main/func_800865F8.s.o(.data);
        build/main/asm/main/main/func_800866F4.s.o(.data);
        build/main/asm/main/main/func_80086848.s.o(.data);
        build/main/asm/main/main/func_80086904.s.o(.data);
        build/main/asm/main/main/func_80086928.s.o(.data);
        build/main/asm/main/main/func_80086A44.s.o(.data);
        build/main/asm/main/main/func_80086BD4.s.o(.data);
        build/main/asm/main/main/func_80086C20.s.o(.data);
        build/main/asm/main/main/func_80086C60.s.o(.data);
        build/main/asm/main/main/func_80086C98.s.o(.data);
        build/main/src/main/main/func_80086D28.c.o(.data);
        build/main/asm/main/main/func_80086D48.s.o(.data);
        build/main/asm/main/main/func_80086DE0.s.o(.data);
        build/main/asm/main/main/func_80086F60.s.o(.data);
        build/main/asm/main/main/func_80087158.s.o(.data);
        build/main/asm/main/main/func_800872A8.s.o(.data);
        build/main/asm/main/main/func_80087318.s.o(.data);
        build/main/asm/main/main/func_80087388.s.o(.data);
        build/main/asm/main/main/func_80087548.s.o(.data);
        build/main/asm/main/main/func_80087678.s.o(.data);
        build/main/asm/main/main/func_800876D8.s.o(.data);
        build/main/asm/main/main/func_80087728.s.o(.data);
        build/main/asm/main/main/func_80087A88.s.o(.data);
        build/main/asm/main/main/func_80087AF8.s.o(.data);
        build/main/asm/main/main/func_80087B50.s.o(.data);
        build/main/asm/main/main/func_80087B78.s.o(.data);
        build/main/asm/main/main/func_80087BC8.s.o(.data);
        build/main/asm/main/main/func_80087C4C.s.o(.data);
        build/main/asm/main/main/func_80087C78.s.o(.data);
        build/main/src/main/main/func_80087D28.c.o(.data);
        build/main/asm/main/main/func_80087D78.s.o(.data);
        build/main/asm/main/main/func_80087D80.s.o(.data);
        build/main/src/main/main/func_80087DBC.c.o(.data);
        build/main/asm/main/main/func_80087DE8.s.o(.data);
        build/main/asm/main/main/func_80087EB8.s.o(.data);
        build/main/asm/main/main/func_80087F54.s.o(.data);
        build/main/asm/main/main/func_80088048.s.o(.data);
        build/main/asm/main/main/func_80088248.s.o(.data);
        build/main/asm/main/main/func_80088310.s.o(.data);
        build/main/asm/main/main/func_80088408.s.o(.data);
        build/main/asm/main/main/func_800884E8.s.o(.data);
        build/main/asm/main/main/func_8008896C.s.o(.data);
        build/main/asm/main/main/func_80088BD0.s.o(.data);
        build/main/asm/main/main/func_80088C98.s.o(.data);
        build/main/asm/main/main/func_80088E9C.s.o(.data);
        build/main/asm/main/main/func_80089018.s.o(.data);
        build/main/asm/main/main/func_800890C8.s.o(.data);
        build/main/asm/main/main/func_80089198.s.o(.data);
        build/main/asm/main/main/func_800891F4.s.o(.data);
        build/main/asm/main/main/func_8008925C.s.o(.data);
        build/main/asm/main/main/func_80089674.s.o(.data);
        build/main/asm/main/main/func_8008980C.s.o(.data);
        build/main/asm/main/main/func_80089A68.s.o(.data);
        build/main/asm/main/main/func_80089B64.s.o(.data);
        build/main/asm/main/main/func_80089E84.s.o(.data);
        build/main/asm/main/main/func_80089EF8.s.o(.data);
        build/main/asm/main/main/func_8008A114.s.o(.data);
        build/main/asm/main/main/func_8008A288.s.o(.data);
        build/main/asm/main/main/func_8008A568.s.o(.data);
        build/main/asm/main/main/func_8008A7A0.s.o(.data);
        build/main/asm/main/main/func_8008A898.s.o(.data);
        build/main/asm/main/main/func_8008A994.s.o(.data);
        build/main/asm/main/main/func_8008AD98.s.o(.data);
        build/main/asm/main/main/func_8008B088.s.o(.data);
        build/main/asm/main/main/func_8008B248.s.o(.data);
        build/main/asm/main/main/func_8008B3E8.s.o(.data);
        build/main/asm/main/main/func_8008B4EC.s.o(.data);
        build/main/asm/main/main/func_8008B5B8.s.o(.data);
        build/main/asm/main/main/func_8008B708.s.o(.data);
        build/main/asm/main/main/func_8008B858.s.o(.data);
        build/main/asm/main/main/func_8008BAC8.s.o(.data);
        build/main/asm/main/main/func_8008C18C.s.o(.data);
        build/main/asm/main/main/func_8008C340.s.o(.data);
        build/main/asm/main/main/func_8008C528.s.o(.data);
        build/main/asm/main/main/func_8008C788.s.o(.data);
        build/main/asm/main/main/func_8008C898.s.o(.data);
        build/main/asm/main/main/func_8008CA00.s.o(.data);
        build/main/asm/main/main/func_8008CB6C.s.o(.data);
        build/main/asm/main/main/func_8008CCE8.s.o(.data);
        build/main/asm/main/main/func_8008CEC0.s.o(.data);
        build/main/asm/main/main/func_8008CF18.s.o(.data);
        build/main/asm/main/main/func_8008D0A8.s.o(.data);
        build/main/asm/main/main/func_8008D188.s.o(.data);
        build/main/asm/main/main/func_8008D3C0.s.o(.data);
        build/main/asm/main/main/func_8008D4EC.s.o(.data);
        build/main/asm/main/main/func_8008D5B0.s.o(.data);
        build/main/asm/main/main/func_8008DC54.s.o(.data);
        build/main/asm/main/main/func_8008DD34.s.o(.data);
        build/main/asm/main/main/func_8008DE28.s.o(.data);
        build/main/asm/main/main/func_8008E2B8.s.o(.data);
        build/main/asm/main/main/func_8008E318.s.o(.data);
        build/main/asm/main/main/func_8008E368.s.o(.data);
        build/main/asm/main/main/func_8008E3C0.s.o(.data);
        build/main/asm/main/main/func_8008E410.s.o(.data);
        build/main/src/main/main/func_8008E458.c.o(.data);
        build/main/asm/main/main/func_8008E4A8.s.o(.data);
        build/main/asm/main/main/func_8008E4B0.s.o(.data);
        build/main/src/main/main/func_8008E4EC.c.o(.data);
        build/main/asm/main/main/func_8008E518.s.o(.data);
        build/main/asm/main/main/func_8008E628.s.o(.data);
        build/main/asm/main/main/func_8008ED50.s.o(.data);
        build/main/src/main/main/func_8008EE18.c.o(.data);
        build/main/asm/main/main/func_8008EE3C.s.o(.data);
        build/main/asm/main/main/func_8008EF38.s.o(.data);
        build/main/asm/main/main/func_8008F5A8.s.o(.data);
        build/main/asm/main/main/func_8008FBF8.s.o(.data);
        build/main/asm/main/main/func_8008FE98.s.o(.data);
        build/main/asm/main/main/func_8008FFA0.s.o(.data);
        build/main/asm/main/main/func_80090028.s.o(.data);
        build/main/asm/main/main/func_80090598.s.o(.data);
        build/main/asm/main/main/func_80090AE8.s.o(.data);
        build/main/asm/main/main/func_80090C38.s.o(.data);
        build/main/asm/main/data/main/data.data.s.o(.data);
        . = ALIGN(., 4);
        main_DATA_END = .;
        main_DATA_SIZE = ABSOLUTE(main_DATA_END - main_DATA_START);
        main_RODATA_START = .;
        build/main/asm/main/main/entry.s.o(.rodata);
        build/main/asm/main/main/func_8004D138.s.o(.rodata);
        build/main/asm/main/main/func_8004D1C8.s.o(.rodata);
        build/main/asm/main/main/func_8004D4B0.s.o(.rodata);
        build/main/asm/main/main/func_8004D504.s.o(.rodata);
        build/main/asm/main/main/func_8004D550.s.o(.rodata);
        build/main/asm/main/main/func_8004D5B4.s.o(.rodata);
        build/main/asm/main/main/func_8004D618.s.o(.rodata);
        build/main/asm/main/main/func_8004D65C.s.o(.rodata);
        build/main/asm/main/main/func_8004D7A0.s.o(.rodata);
        build/main/asm/main/main/func_8004D808.s.o(.rodata);
        build/main/asm/main/main/func_8004DC24.s.o(.rodata);
        build/main/asm/main/main/func_8004E094.s.o(.rodata);
        build/main/asm/main/main/func_8004E0F8.s.o(.rodata);
        build/main/asm/main/main/func_8004E1B8.s.o(.rodata);
        build/main/asm/main/main/func_8004E21C.s.o(.rodata);
        build/main/asm/main/main/func_8004E4E4.s.o(.rodata);
        build/main/asm/main/main/func_8004E594.s.o(.rodata);
        build/main/asm/main/main/func_8004E5F0.s.o(.rodata);
        build/main/asm/main/main/func_8004E670.s.o(.rodata);
        build/main/asm/main/main/func_8004E6C8.s.o(.rodata);
        build/main/asm/main/main/func_8004E6F4.s.o(.rodata);
        build/main/asm/main/main/func_8004E76C.s.o(.rodata);
        build/main/asm/main/main/func_8004E7A8.s.o(.rodata);
        build/main/asm/main/main/func_8004EC54.s.o(.rodata);
        build/main/asm/main/main/func_8004EC88.s.o(.rodata);
        build/main/asm/main/main/func_8004EE64.s.o(.rodata);
        build/main/src/main/main/func_8004EF5C.c.o(.rodata);
        build/main/asm/main/main/func_8004EF78.s.o(.rodata);
        build/main/asm/main/main/func_8004EFFC.s.o(.rodata);
        build/main/asm/main/main/func_8004F31C.s.o(.rodata);
        build/main/asm/main/main/func_8004F3B8.s.o(.rodata);
        build/main/asm/main/main/func_8004F440.s.o(.rodata);
        build/main/asm/main/main/func_8004F4AC.s.o(.rodata);
        build/main/asm/main/main/func_8004FCF8.s.o(.rodata);
        build/main/asm/main/main/func_80050260.s.o(.rodata);
        build/main/src/main/main/func_800502B8.c.o(.rodata);
        build/main/src/main/main/func_800502D4.c.o(.rodata);
        build/main/asm/main/main/func_800502F4.s.o(.rodata);
        build/main/asm/main/main/func_80050408.s.o(.rodata);
        build/main/asm/main/main/func_800521BC.s.o(.rodata);
        build/main/asm/main/main/func_8005252C.s.o(.rodata);
        build/main/asm/main/main/func_80052BB0.s.o(.rodata);
        build/main/asm/main/main/func_80052F5C.s.o(.rodata);
        build/main/asm/main/main/func_80053F00.s.o(.rodata);
        build/main/asm/main/main/func_800541C0.s.o(.rodata);
        build/main/asm/main/main/func_800555D8.s.o(.rodata);
        build/main/asm/main/main/func_8005566C.s.o(.rodata);
        build/main/asm/main/main/func_80056424.s.o(.rodata);
        build/main/asm/main/main/func_8005685C.s.o(.rodata);
        build/main/asm/main/main/func_800568F4.s.o(.rodata);
        build/main/asm/main/main/func_8005698C.s.o(.rodata);
        build/main/asm/main/main/func_80056A18.s.o(.rodata);
        build/main/asm/main/main/func_80056DE0.s.o(.rodata);
        build/main/asm/main/main/func_80056EAC.s.o(.rodata);
        build/main/asm/main/main/func_800577A8.s.o(.rodata);
        build/main/asm/main/main/func_80057A94.s.o(.rodata);
        build/main/asm/main/main/func_80057AC4.s.o(.rodata);
        build/main/asm/main/main/func_80057DB4.s.o(.rodata);
        build/main/asm/main/main/func_80058138.s.o(.rodata);
        build/main/asm/main/main/func_80058294.s.o(.rodata);
        build/main/asm/main/main/func_80058584.s.o(.rodata);
        build/main/asm/main/main/func_800586CC.s.o(.rodata);
        build/main/asm/main/main/func_8005A978.s.o(.rodata);
        build/main/asm/main/main/func_8005AA64.s.o(.rodata);
        build/main/asm/main/main/func_8005AA98.s.o(.rodata);
        build/main/asm/main/main/func_8005AB30.s.o(.rodata);
        build/main/asm/main/main/func_8005AB80.s.o(.rodata);
        build/main/asm/main/main/func_8005AC70.s.o(.rodata);
        build/main/asm/main/main/func_8005AFC4.s.o(.rodata);
        build/main/asm/main/main/func_8005B224.s.o(.rodata);
        build/main/asm/main/main/func_8005B7D8.s.o(.rodata);
        build/main/asm/main/main/func_8005B874.s.o(.rodata);
        build/main/src/main/main/func_8005BDB4.c.o(.rodata);
        build/main/asm/main/main/func_8005BDD0.s.o(.rodata);
        build/main/asm/main/main/func_8005BDF0.s.o(.rodata);
        build/main/asm/main/main/func_8005BF64.s.o(.rodata);
        build/main/asm/main/main/func_8005C010.s.o(.rodata);
        build/main/asm/main/main/func_8005C0BC.s.o(.rodata);
        build/main/asm/main/main/func_8005C540.s.o(.rodata);
        build/main/asm/main/main/func_8005C688.s.o(.rodata);
        build/main/asm/main/main/func_8005C8B8.s.o(.rodata);
        build/main/asm/main/main/func_8005C9BC.s.o(.rodata);
        build/main/asm/main/main/func_8005D0C8.s.o(.rodata);
        build/main/asm/main/main/func_8005D178.s.o(.rodata);
        build/main/asm/main/main/func_8005D9C0.s.o(.rodata);
        build/main/asm/main/main/func_8005DED4.s.o(.rodata);
        build/main/asm/main/main/func_8005DF20.s.o(.rodata);
        build/main/asm/main/main/func_8005DFAC.s.o(.rodata);
        build/main/asm/main/main/func_8005E004.s.o(.rodata);
        build/main/asm/main/main/func_8005E04C.s.o(.rodata);
        build/main/asm/main/main/func_8005E09C.s.o(.rodata);
        build/main/asm/main/main/func_8005E1B4.s.o(.rodata);
        build/main/asm/main/main/func_8005E2E4.s.o(.rodata);
        build/main/asm/main/main/func_8005E544.s.o(.rodata);
        build/main/asm/main/main/func_8005E5A4.s.o(.rodata);
        build/main/asm/main/main/func_8005E8B4.s.o(.rodata);
        build/main/asm/main/main/func_8005F530.s.o(.rodata);
        build/main/asm/main/main/func_8005F5B0.s.o(.rodata);
        build/main/asm/main/main/func_8005F6B8.s.o(.rodata);
        build/main/asm/main/main/func_8005F838.s.o(.rodata);
        build/main/asm/main/main/func_8005F980.s.o(.rodata);
        build/main/asm/main/main/func_8005FC3C.s.o(.rodata);
        build/main/asm/main/main/func_8005FCC0.s.o(.rodata);
        build/main/asm/main/main/func_8005FF44.s.o(.rodata);
        build/main/asm/main/main/func_800600D8.s.o(.rodata);
        build/main/asm/main/main/func_800602A0.s.o(.rodata);
        build/main/asm/main/main/func_80060834.s.o(.rodata);
        build/main/asm/main/main/func_80060960.s.o(.rodata);
        build/main/asm/main/main/func_80060B9C.s.o(.rodata);
        build/main/asm/main/main/func_80060DD8.s.o(.rodata);
        build/main/asm/main/main/func_8006114C.s.o(.rodata);
        build/main/asm/main/main/func_80061800.s.o(.rodata);
        build/main/asm/main/main/func_80061894.s.o(.rodata);
        build/main/asm/main/main/func_80061C70.s.o(.rodata);
        build/main/asm/main/main/func_80061CF0.s.o(.rodata);
        build/main/asm/main/main/func_80061EA4.s.o(.rodata);
        build/main/asm/main/main/func_80061EC8.s.o(.rodata);
        build/main/asm/main/main/func_80061EE8.s.o(.rodata);
        build/main/asm/main/main/func_80061F0C.s.o(.rodata);
        build/main/asm/main/main/func_80061FB4.s.o(.rodata);
        build/main/asm/main/main/func_800621C0.s.o(.rodata);
        build/main/asm/main/main/func_800625C8.s.o(.rodata);
        build/main/asm/main/main/func_80062878.s.o(.rodata);
        build/main/asm/main/main/func_80062B0C.s.o(.rodata);
        build/main/asm/main/main/func_80062CE8.s.o(.rodata);
        build/main/asm/main/main/func_80062D98.s.o(.rodata);
        build/main/asm/main/main/func_80063158.s.o(.rodata);
        build/main/asm/main/main/func_800634DC.s.o(.rodata);
        build/main/asm/main/main/func_80063650.s.o(.rodata);
        build/main/asm/main/main/func_80063A3C.s.o(.rodata);
        build/main/asm/main/main/func_80063B14.s.o(.rodata);
        build/main/asm/main/main/func_80063B9C.s.o(.rodata);
        build/main/asm/main/main/func_80063C08.s.o(.rodata);
        build/main/asm/main/main/func_80063CD8.s.o(.rodata);
        build/main/asm/main/main/func_80063DF0.s.o(.rodata);
        build/main/asm/main/main/func_80063F7C.s.o(.rodata);
        build/main/asm/main/main/func_8006421C.s.o(.rodata);
        build/main/asm/main/main/func_80065224.s.o(.rodata);
        build/main/asm/main/main/func_80065274.s.o(.rodata);
        build/main/asm/main/main/func_800652D8.s.o(.rodata);
        build/main/asm/main/main/func_80065370.s.o(.rodata);
        build/main/asm/main/main/func_80065424.s.o(.rodata);
        build/main/asm/main/main/func_80065560.s.o(.rodata);
        build/main/asm/main/main/func_80065648.s.o(.rodata);
        build/main/asm/main/main/func_8006584C.s.o(.rodata);
        build/main/asm/main/main/func_80065964.s.o(.rodata);
        build/main/asm/main/main/func_80065BDC.s.o(.rodata);
        build/main/asm/main/main/func_800661AC.s.o(.rodata);
        build/main/asm/main/main/func_80066400.s.o(.rodata);
        build/main/asm/main/main/func_80066580.s.o(.rodata);
        build/main/asm/main/main/func_80066C44.s.o(.rodata);
        build/main/asm/main/main/func_800676DC.s.o(.rodata);
        build/main/asm/main/main/func_80067DB4.s.o(.rodata);
        build/main/asm/main/main/func_80068D2C.s.o(.rodata);
        build/main/asm/main/main/func_800693BC.s.o(.rodata);
        build/main/asm/main/main/func_80069A60.s.o(.rodata);
        build/main/asm/main/main/func_8006AE78.s.o(.rodata);
        build/main/asm/main/main/func_8006C128.s.o(.rodata);
        build/main/asm/main/main/func_8006CD8C.s.o(.rodata);
        build/main/asm/main/main/func_8006CE9C.s.o(.rodata);
        build/main/asm/main/main/func_8006CF98.s.o(.rodata);
        build/main/asm/main/main/func_8006D1FC.s.o(.rodata);
        build/main/asm/main/main/func_800701C8.s.o(.rodata);
        build/main/asm/main/main/func_80070454.s.o(.rodata);
        build/main/asm/main/main/func_800705F0.s.o(.rodata);
        build/main/asm/main/main/func_800707B0.s.o(.rodata);
        build/main/asm/main/main/func_80070B0C.s.o(.rodata);
        build/main/asm/main/main/func_80070B24.s.o(.rodata);
        build/main/asm/main/main/func_80070BCC.s.o(.rodata);
        build/main/asm/main/main/func_80070C3C.s.o(.rodata);
        build/main/asm/main/main/func_80070C88.s.o(.rodata);
        build/main/asm/main/main/func_80070CD4.s.o(.rodata);
        build/main/asm/main/main/func_80070D50.s.o(.rodata);
        build/main/asm/main/main/func_80070DC4.s.o(.rodata);
        build/main/asm/main/main/func_80070E40.s.o(.rodata);
        build/main/asm/main/main/func_80070F50.s.o(.rodata);
        build/main/asm/main/main/func_80071108.s.o(.rodata);
        build/main/asm/main/main/func_80071360.s.o(.rodata);
        build/main/asm/main/main/func_80071408.s.o(.rodata);
        build/main/asm/main/main/func_800716E4.s.o(.rodata);
        build/main/asm/main/main/func_80071A28.s.o(.rodata);
        build/main/asm/main/main/func_80071D04.s.o(.rodata);
        build/main/asm/main/main/func_80071EA4.s.o(.rodata);
        build/main/asm/main/main/func_800721A8.s.o(.rodata);
        build/main/asm/main/main/func_80072340.s.o(.rodata);
        build/main/asm/main/main/func_80072550.s.o(.rodata);
        build/main/asm/main/main/func_800727EC.s.o(.rodata);
        build/main/asm/main/main/func_80072AD4.s.o(.rodata);
        build/main/asm/main/main/func_80072E00.s.o(.rodata);
        build/main/asm/main/main/func_80073480.s.o(.rodata);
        build/main/asm/main/main/func_80074E30.s.o(.rodata);
        build/main/asm/main/main/func_80074E6C.s.o(.rodata);
        build/main/asm/main/main/func_80074EA0.s.o(.rodata);
        build/main/asm/main/main/func_80074ED8.s.o(.rodata);
        build/main/asm/main/main/func_80074FC4.s.o(.rodata);
        build/main/asm/main/main/func_80075004.s.o(.rodata);
        build/main/asm/main/main/func_80075044.s.o(.rodata);
        build/main/asm/main/main/func_8007515C.s.o(.rodata);
        build/main/asm/main/main/func_80075270.s.o(.rodata);
        build/main/asm/main/main/func_800752E8.s.o(.rodata);
        build/main/asm/main/main/func_80075360.s.o(.rodata);
        build/main/asm/main/main/func_8007544C.s.o(.rodata);
        build/main/asm/main/main/func_80075518.s.o(.rodata);
        build/main/asm/main/main/func_8007558C.s.o(.rodata);
        build/main/asm/main/main/func_8007573C.s.o(.rodata);
        build/main/asm/main/main/func_8007583C.s.o(.rodata);
        build/main/asm/main/main/func_80075908.s.o(.rodata);
        build/main/asm/main/main/func_80075B78.s.o(.rodata);
        build/main/asm/main/main/func_80075C30.s.o(.rodata);
        build/main/asm/main/main/func_80075C7C.s.o(.rodata);
        build/main/asm/main/main/func_80075D0C.s.o(.rodata);
        build/main/asm/main/main/func_80075D9C.s.o(.rodata);
        build/main/asm/main/main/func_80075E04.s.o(.rodata);
        build/main/asm/main/main/func_80075EC8.s.o(.rodata);
        build/main/asm/main/main/func_80075F90.s.o(.rodata);
        build/main/asm/main/main/func_80076344.s.o(.rodata);
        build/main/asm/main/main/func_80079F28.s.o(.rodata);
        build/main/asm/main/main/func_80079F58.s.o(.rodata);
        build/main/asm/main/main/func_8007A210.s.o(.rodata);
        build/main/asm/main/main/func_8007A298.s.o(.rodata);
        build/main/asm/main/main/func_8007A6D8.s.o(.rodata);
        build/main/src/main/main/func_8007A8E0.c.o(.rodata);
        build/main/asm/main/main/func_8007A918.s.o(.rodata);
        build/main/asm/main/main/func_8007AA68.s.o(.rodata);
        build/main/asm/main/main/func_8007ABD8.s.o(.rodata);
        build/main/src/main/main/func_8007AC38.c.o(.rodata);
        build/main/asm/main/main/func_8007AC98.s.o(.rodata);
        build/main/asm/main/main/func_8007AD28.s.o(.rodata);
        build/main/asm/main/main/func_8007AE7C.s.o(.rodata);
        build/main/asm/main/main/func_8007AEE8.s.o(.rodata);
        build/main/asm/main/main/func_8007B118.s.o(.rodata);
        build/main/asm/main/main/func_8007B178.s.o(.rodata);
        build/main/asm/main/main/func_8007B318.s.o(.rodata);
        build/main/asm/main/main/func_8007B380.s.o(.rodata);
        build/main/asm/main/main/func_8007B4C0.s.o(.rodata);
        build/main/asm/main/main/func_8007B508.s.o(.rodata);
        build/main/asm/main/main/func_8007B568.s.o(.rodata);
        build/main/src/main/main/func_8007B7D8.c.o(.rodata);
        build/main/asm/main/main/func_8007B820.s.o(.rodata);
        build/main/asm/main/main/func_8007B890.s.o(.rodata);
        build/main/asm/main/main/func_8007BA28.s.o(.rodata);
        build/main/asm/main/main/func_8007BD08_merged.s.o(.rodata);
        build/main/asm/main/main/func_8007C848.s.o(.rodata);
        build/main/asm/main/main/func_8007C948.s.o(.rodata);
        build/main/asm/main/main/func_8007C9E8.s.o(.rodata);
        build/main/asm/main/main/func_8007CD08.s.o(.rodata);
        build/main/asm/main/main/func_8007CE48.s.o(.rodata);
        build/main/asm/main/main/func_8007CF98.s.o(.rodata);
        build/main/asm/main/main/func_8007D008.s.o(.rodata);
        build/main/asm/main/main/func_8007D0E8.s.o(.rodata);
        build/main/asm/main/main/func_8007D240.s.o(.rodata);
        build/main/asm/main/main/func_8007D30C.s.o(.rodata);
        build/main/asm/main/main/func_8007D47C.s.o(.rodata);
        build/main/asm/main/main/func_8007D4F0.s.o(.rodata);
        build/main/asm/main/main/func_8007D688.s.o(.rodata);
        build/main/asm/main/main/func_8007D8CC.s.o(.rodata);
        build/main/asm/main/main/func_8007DA74.s.o(.rodata);
        build/main/asm/main/main/func_8007DAB0.s.o(.rodata);
        build/main/asm/main/main/func_8007DD1C.s.o(.rodata);
        build/main/asm/main/main/func_8007DD7C.s.o(.rodata);
        build/main/asm/main/main/func_8007E074.s.o(.rodata);
        build/main/asm/main/main/func_8007E188.s.o(.rodata);
        build/main/src/main/main/func_8007E5E8.c.o(.rodata);
        build/main/asm/main/main/func_8007E618.s.o(.rodata);
        build/main/asm/main/main/func_8007E6C4.s.o(.rodata);
        build/main/asm/main/main/func_8007E734.s.o(.rodata);
        build/main/asm/main/main/func_8007E858.s.o(.rodata);
        build/main/asm/main/main/func_8007E8E4.s.o(.rodata);
        build/main/asm/main/main/func_8007E9D8.s.o(.rodata);
        build/main/asm/main/main/func_8007EA18.s.o(.rodata);
        build/main/asm/main/main/func_8007EA68.s.o(.rodata);
        build/main/asm/main/main/func_8007EAA8.s.o(.rodata);
        build/main/src/main/main/func_8007EAE8.c.o(.rodata);
        build/main/asm/main/main/func_8007EB18.s.o(.rodata);
        build/main/asm/main/main/func_8007EBC4.s.o(.rodata);
        build/main/asm/main/main/func_8007ED94.s.o(.rodata);
        build/main/asm/main/main/func_8007F5C4.s.o(.rodata);
        build/main/asm/main/main/func_8007FBD8.s.o(.rodata);
        build/main/asm/main/main/func_8007FE7C.s.o(.rodata);
        build/main/asm/main/main/func_8007FFE4.s.o(.rodata);
        build/main/asm/main/main/func_80080110.s.o(.rodata);
        build/main/asm/main/main/func_80080228.s.o(.rodata);
        build/main/asm/main/main/func_800805A4.s.o(.rodata);
        build/main/asm/main/main/func_80080DC4.s.o(.rodata);
        build/main/asm/main/main/func_800813E8.s.o(.rodata);
        build/main/asm/main/main/func_800814EC.s.o(.rodata);
        build/main/asm/main/main/func_8008155C.s.o(.rodata);
        build/main/asm/main/main/func_8008177C.s.o(.rodata);
        build/main/asm/main/main/func_80081900.s.o(.rodata);
        build/main/asm/main/main/func_80081B58.s.o(.rodata);
        build/main/asm/main/main/func_80081C30.s.o(.rodata);
        build/main/asm/main/main/func_80081D08.s.o(.rodata);
        build/main/asm/main/main/func_80081D94.s.o(.rodata);
        build/main/asm/main/main/func_800822DC.s.o(.rodata);
        build/main/asm/main/main/func_80082528.s.o(.rodata);
        build/main/asm/main/main/func_80082598.s.o(.rodata);
        build/main/asm/main/main/func_80082608.s.o(.rodata);
        build/main/asm/main/main/func_80082698.s.o(.rodata);
        build/main/asm/main/main/func_800826F8.s.o(.rodata);
        build/main/asm/main/main/func_80082758.s.o(.rodata);
        build/main/src/main/main/func_80082818.c.o(.rodata);
        build/main/asm/main/main/func_80082850.s.o(.rodata);
        build/main/asm/main/main/func_80082900.s.o(.rodata);
        build/main/asm/main/main/func_80082B98.s.o(.rodata);
        build/main/src/main/main/func_80082E98.c.o(.rodata);
        build/main/src/main/main/func_80082EDC.c.o(.rodata);
        build/main/src/main/main/func_80082F30.c.o(.rodata);
        build/main/asm/main/main/func_80082F84.s.o(.rodata);
        build/main/asm/main/main/func_8008300C.s.o(.rodata);
        build/main/asm/main/main/func_800830B4.s.o(.rodata);
        build/main/asm/main/main/func_800831F8.s.o(.rodata);
        build/main/asm/main/main/func_80083638.s.o(.rodata);
        build/main/asm/main/main/func_8008380C.s.o(.rodata);
        build/main/asm/main/main/func_80083BB8.s.o(.rodata);
        build/main/asm/main/main/func_80083CE4.s.o(.rodata);
        build/main/asm/main/main/func_800841B8.s.o(.rodata);
        build/main/src/main/main/func_800843AC.c.o(.rodata);
        build/main/asm/main/main/func_8008448C.s.o(.rodata);
        build/main/asm/main/main/func_8008465C.s.o(.rodata);
        build/main/asm/main/main/func_800849A4.s.o(.rodata);
        build/main/asm/main/main/func_80084F48.s.o(.rodata);
        build/main/asm/main/main/func_8008506C.s.o(.rodata);
        build/main/asm/main/main/func_80085154.s.o(.rodata);
        build/main/asm/main/main/func_80085410.s.o(.rodata);
        build/main/asm/main/main/func_800854C8.s.o(.rodata);
        build/main/asm/main/main/func_80085650.s.o(.rodata);
        build/main/asm/main/main/func_800857DC.s.o(.rodata);
        build/main/asm/main/main/func_80085A04.s.o(.rodata);
        build/main/asm/main/main/func_80085C74.s.o(.rodata);
        build/main/asm/main/main/func_80085FEC.s.o(.rodata);
        build/main/asm/main/main/func_80086088.s.o(.rodata);
        build/main/asm/main/main/func_800860D8.s.o(.rodata);
        build/main/asm/main/main/func_80086188.s.o(.rodata);
        build/main/asm/main/main/func_80086208.s.o(.rodata);
        build/main/asm/main/main/func_80086298.s.o(.rodata);
        build/main/asm/main/main/func_80086388.s.o(.rodata);
        build/main/asm/main/main/func_80086418.s.o(.rodata);
        build/main/asm/main/main/func_800864B8.s.o(.rodata);
        build/main/asm/main/main/func_80086558.s.o(.rodata);
        build/main/asm/main/main/func_800865F8.s.o(.rodata);
        build/main/asm/main/main/func_800866F4.s.o(.rodata);
        build/main/asm/main/main/func_80086848.s.o(.rodata);
        build/main/asm/main/main/func_80086904.s.o(.rodata);
        build/main/asm/main/main/func_80086928.s.o(.rodata);
        build/main/asm/main/main/func_80086A44.s.o(.rodata);
        build/main/asm/main/main/func_80086BD4.s.o(.rodata);
        build/main/asm/main/main/func_80086C20.s.o(.rodata);
        build/main/asm/main/main/func_80086C60.s.o(.rodata);
        build/main/asm/main/main/func_80086C98.s.o(.rodata);
        build/main/src/main/main/func_80086D28.c.o(.rodata);
        build/main/asm/main/main/func_80086D48.s.o(.rodata);
        build/main/asm/main/main/func_80086DE0.s.o(.rodata);
        build/main/asm/main/main/func_80086F60.s.o(.rodata);
        build/main/asm/main/main/func_80087158.s.o(.rodata);
        build/main/asm/main/main/func_800872A8.s.o(.rodata);
        build/main/asm/main/main/func_80087318.s.o(.rodata);
        build/main/asm/main/main/func_80087388.s.o(.rodata);
        build/main/asm/main/main/func_80087548.s.o(.rodata);
        build/main/asm/main/main/func_80087678.s.o(.rodata);
        build/main/asm/main/main/func_800876D8.s.o(.rodata);
        build/main/asm/main/main/func_80087728.s.o(.rodata);
        build/main/asm/main/main/func_80087A88.s.o(.rodata);
        build/main/asm/main/main/func_80087AF8.s.o(.rodata);
        build/main/asm/main/main/func_80087B50.s.o(.rodata);
        build/main/asm/main/main/func_80087B78.s.o(.rodata);
        build/main/asm/main/main/func_80087BC8.s.o(.rodata);
        build/main/asm/main/main/func_80087C4C.s.o(.rodata);
        build/main/asm/main/main/func_80087C78.s.o(.rodata);
        build/main/src/main/main/func_80087D28.c.o(.rodata);
        build/main/asm/main/main/func_80087D78.s.o(.rodata);
        build/main/asm/main/main/func_80087D80.s.o(.rodata);
        build/main/src/main/main/func_80087DBC.c.o(.rodata);
        build/main/asm/main/main/func_80087DE8.s.o(.rodata);
        build/main/asm/main/main/func_80087EB8.s.o(.rodata);
        build/main/asm/main/main/func_80087F54.s.o(.rodata);
        build/main/asm/main/main/func_80088048.s.o(.rodata);
        build/main/asm/main/main/func_80088248.s.o(.rodata);
        build/main/asm/main/main/func_80088310.s.o(.rodata);
        build/main/asm/main/main/func_80088408.s.o(.rodata);
        build/main/asm/main/main/func_800884E8.s.o(.rodata);
        build/main/asm/main/main/func_8008896C.s.o(.rodata);
        build/main/asm/main/main/func_80088BD0.s.o(.rodata);
        build/main/asm/main/main/func_80088C98.s.o(.rodata);
        build/main/asm/main/main/func_80088E9C.s.o(.rodata);
        build/main/asm/main/main/func_80089018.s.o(.rodata);
        build/main/asm/main/main/func_800890C8.s.o(.rodata);
        build/main/asm/main/main/func_80089198.s.o(.rodata);
        build/main/asm/main/main/func_800891F4.s.o(.rodata);
        build/main/asm/main/main/func_8008925C.s.o(.rodata);
        build/main/asm/main/main/func_80089674.s.o(.rodata);
        build/main/asm/main/main/func_8008980C.s.o(.rodata);
        build/main/asm/main/main/func_80089A68.s.o(.rodata);
        build/main/asm/main/main/func_80089B64.s.o(.rodata);
        build/main/asm/main/main/func_80089E84.s.o(.rodata);
        build/main/asm/main/main/func_80089EF8.s.o(.rodata);
        build/main/asm/main/main/func_8008A114.s.o(.rodata);
        build/main/asm/main/main/func_8008A288.s.o(.rodata);
        build/main/asm/main/main/func_8008A568.s.o(.rodata);
        build/main/asm/main/main/func_8008A7A0.s.o(.rodata);
        build/main/asm/main/main/func_8008A898.s.o(.rodata);
        build/main/asm/main/main/func_8008A994.s.o(.rodata);
        build/main/asm/main/main/func_8008AD98.s.o(.rodata);
        build/main/asm/main/main/func_8008B088.s.o(.rodata);
        build/main/asm/main/main/func_8008B248.s.o(.rodata);
        build/main/asm/main/main/func_8008B3E8.s.o(.rodata);
        build/main/asm/main/main/func_8008B4EC.s.o(.rodata);
        build/main/asm/main/main/func_8008B5B8.s.o(.rodata);
        build/main/asm/main/main/func_8008B708.s.o(.rodata);
        build/main/asm/main/main/func_8008B858.s.o(.rodata);
        build/main/asm/main/main/func_8008BAC8.s.o(.rodata);
        build/main/asm/main/main/func_8008C18C.s.o(.rodata);
        build/main/asm/main/main/func_8008C340.s.o(.rodata);
        build/main/asm/main/main/func_8008C528.s.o(.rodata);
        build/main/asm/main/main/func_8008C788.s.o(.rodata);
        build/main/asm/main/main/func_8008C898.s.o(.rodata);
        build/main/asm/main/main/func_8008CA00.s.o(.rodata);
        build/main/asm/main/main/func_8008CB6C.s.o(.rodata);
        build/main/asm/main/main/func_8008CCE8.s.o(.rodata);
        build/main/asm/main/main/func_8008CEC0.s.o(.rodata);
        build/main/asm/main/main/func_8008CF18.s.o(.rodata);
        build/main/asm/main/main/func_8008D0A8.s.o(.rodata);
        build/main/asm/main/main/func_8008D188.s.o(.rodata);
        build/main/asm/main/main/func_8008D3C0.s.o(.rodata);
        build/main/asm/main/main/func_8008D4EC.s.o(.rodata);
        build/main/asm/main/main/func_8008D5B0.s.o(.rodata);
        build/main/asm/main/main/func_8008DC54.s.o(.rodata);
        build/main/asm/main/main/func_8008DD34.s.o(.rodata);
        build/main/asm/main/main/func_8008DE28.s.o(.rodata);
        build/main/asm/main/main/func_8008E2B8.s.o(.rodata);
        build/main/asm/main/main/func_8008E318.s.o(.rodata);
        build/main/asm/main/main/func_8008E368.s.o(.rodata);
        build/main/asm/main/main/func_8008E3C0.s.o(.rodata);
        build/main/asm/main/main/func_8008E410.s.o(.rodata);
        build/main/src/main/main/func_8008E458.c.o(.rodata);
        build/main/asm/main/main/func_8008E4A8.s.o(.rodata);
        build/main/asm/main/main/func_8008E4B0.s.o(.rodata);
        build/main/src/main/main/func_8008E4EC.c.o(.rodata);
        build/main/asm/main/main/func_8008E518.s.o(.rodata);
        build/main/asm/main/main/func_8008E628.s.o(.rodata);
        build/main/asm/main/main/func_8008ED50.s.o(.rodata);
        build/main/src/main/main/func_8008EE18.c.o(.rodata);
        build/main/asm/main/main/func_8008EE3C.s.o(.rodata);
        build/main/asm/main/main/func_8008EF38.s.o(.rodata);
        build/main/asm/main/main/func_8008F5A8.s.o(.rodata);
        build/main/asm/main/main/func_8008FBF8.s.o(.rodata);
        build/main/asm/main/main/func_8008FE98.s.o(.rodata);
        build/main/asm/main/main/func_8008FFA0.s.o(.rodata);
        build/main/asm/main/main/func_80090028.s.o(.rodata);
        build/main/asm/main/main/func_80090598.s.o(.rodata);
        build/main/asm/main/main/func_80090AE8.s.o(.rodata);
        build/main/asm/main/main/func_80090C38.s.o(.rodata);
        . = ALIGN(., 4);
        main_RODATA_END = .;
        main_RODATA_SIZE = ABSOLUTE(main_RODATA_END - main_RODATA_START);
    }
    main_bss_VRAM = ADDR(.main_bss);
    .main_bss (NOLOAD) : SUBALIGN(4)
    {
        FILL(0x00000000);
        main_BSS_START = .;
        build/main/asm/main/main/entry.s.o(.bss);
        build/main/asm/main/main/func_8004D138.s.o(.bss);
        build/main/asm/main/main/func_8004D1C8.s.o(.bss);
        build/main/asm/main/main/func_8004D4B0.s.o(.bss);
        build/main/asm/main/main/func_8004D504.s.o(.bss);
        build/main/asm/main/main/func_8004D550.s.o(.bss);
        build/main/asm/main/main/func_8004D5B4.s.o(.bss);
        build/main/asm/main/main/func_8004D618.s.o(.bss);
        build/main/asm/main/main/func_8004D65C.s.o(.bss);
        build/main/asm/main/main/func_8004D7A0.s.o(.bss);
        build/main/asm/main/main/func_8004D808.s.o(.bss);
        build/main/asm/main/main/func_8004DC24.s.o(.bss);
        build/main/asm/main/main/func_8004E094.s.o(.bss);
        build/main/asm/main/main/func_8004E0F8.s.o(.bss);
        build/main/asm/main/main/func_8004E1B8.s.o(.bss);
        build/main/asm/main/main/func_8004E21C.s.o(.bss);
        build/main/asm/main/main/func_8004E4E4.s.o(.bss);
        build/main/asm/main/main/func_8004E594.s.o(.bss);
        build/main/asm/main/main/func_8004E5F0.s.o(.bss);
        build/main/asm/main/main/func_8004E670.s.o(.bss);
        build/main/asm/main/main/func_8004E6C8.s.o(.bss);
        build/main/asm/main/main/func_8004E6F4.s.o(.bss);
        build/main/asm/main/main/func_8004E76C.s.o(.bss);
        build/main/asm/main/main/func_8004E7A8.s.o(.bss);
        build/main/asm/main/main/func_8004EC54.s.o(.bss);
        build/main/asm/main/main/func_8004EC88.s.o(.bss);
        build/main/asm/main/main/func_8004EE64.s.o(.bss);
        build/main/src/main/main/func_8004EF5C.c.o(.bss);
        build/main/asm/main/main/func_8004EF78.s.o(.bss);
        build/main/asm/main/main/func_8004EFFC.s.o(.bss);
        build/main/asm/main/main/func_8004F31C.s.o(.bss);
        build/main/asm/main/main/func_8004F3B8.s.o(.bss);
        build/main/asm/main/main/func_8004F440.s.o(.bss);
        build/main/asm/main/main/func_8004F4AC.s.o(.bss);
        build/main/asm/main/main/func_8004FCF8.s.o(.bss);
        build/main/asm/main/main/func_80050260.s.o(.bss);
        build/main/src/main/main/func_800502B8.c.o(.bss);
        build/main/src/main/main/func_800502D4.c.o(.bss);
        build/main/asm/main/main/func_800502F4.s.o(.bss);
        build/main/asm/main/main/func_80050408.s.o(.bss);
        build/main/asm/main/main/func_800521BC.s.o(.bss);
        build/main/asm/main/main/func_8005252C.s.o(.bss);
        build/main/asm/main/main/func_80052BB0.s.o(.bss);
        build/main/asm/main/main/func_80052F5C.s.o(.bss);
        build/main/asm/main/main/func_80053F00.s.o(.bss);
        build/main/asm/main/main/func_800541C0.s.o(.bss);
        build/main/asm/main/main/func_800555D8.s.o(.bss);
        build/main/asm/main/main/func_8005566C.s.o(.bss);
        build/main/asm/main/main/func_80056424.s.o(.bss);
        build/main/asm/main/main/func_8005685C.s.o(.bss);
        build/main/asm/main/main/func_800568F4.s.o(.bss);
        build/main/asm/main/main/func_8005698C.s.o(.bss);
        build/main/asm/main/main/func_80056A18.s.o(.bss);
        build/main/asm/main/main/func_80056DE0.s.o(.bss);
        build/main/asm/main/main/func_80056EAC.s.o(.bss);
        build/main/asm/main/main/func_800577A8.s.o(.bss);
        build/main/asm/main/main/func_80057A94.s.o(.bss);
        build/main/asm/main/main/func_80057AC4.s.o(.bss);
        build/main/asm/main/main/func_80057DB4.s.o(.bss);
        build/main/asm/main/main/func_80058138.s.o(.bss);
        build/main/asm/main/main/func_80058294.s.o(.bss);
        build/main/asm/main/main/func_80058584.s.o(.bss);
        build/main/asm/main/main/func_800586CC.s.o(.bss);
        build/main/asm/main/main/func_8005A978.s.o(.bss);
        build/main/asm/main/main/func_8005AA64.s.o(.bss);
        build/main/asm/main/main/func_8005AA98.s.o(.bss);
        build/main/asm/main/main/func_8005AB30.s.o(.bss);
        build/main/asm/main/main/func_8005AB80.s.o(.bss);
        build/main/asm/main/main/func_8005AC70.s.o(.bss);
        build/main/asm/main/main/func_8005AFC4.s.o(.bss);
        build/main/asm/main/main/func_8005B224.s.o(.bss);
        build/main/asm/main/main/func_8005B7D8.s.o(.bss);
        build/main/asm/main/main/func_8005B874.s.o(.bss);
        build/main/src/main/main/func_8005BDB4.c.o(.bss);
        build/main/asm/main/main/func_8005BDD0.s.o(.bss);
        build/main/asm/main/main/func_8005BDF0.s.o(.bss);
        build/main/asm/main/main/func_8005BF64.s.o(.bss);
        build/main/asm/main/main/func_8005C010.s.o(.bss);
        build/main/asm/main/main/func_8005C0BC.s.o(.bss);
        build/main/asm/main/main/func_8005C540.s.o(.bss);
        build/main/asm/main/main/func_8005C688.s.o(.bss);
        build/main/asm/main/main/func_8005C8B8.s.o(.bss);
        build/main/asm/main/main/func_8005C9BC.s.o(.bss);
        build/main/asm/main/main/func_8005D0C8.s.o(.bss);
        build/main/asm/main/main/func_8005D178.s.o(.bss);
        build/main/asm/main/main/func_8005D9C0.s.o(.bss);
        build/main/asm/main/main/func_8005DED4.s.o(.bss);
        build/main/asm/main/main/func_8005DF20.s.o(.bss);
        build/main/asm/main/main/func_8005DFAC.s.o(.bss);
        build/main/asm/main/main/func_8005E004.s.o(.bss);
        build/main/asm/main/main/func_8005E04C.s.o(.bss);
        build/main/asm/main/main/func_8005E09C.s.o(.bss);
        build/main/asm/main/main/func_8005E1B4.s.o(.bss);
        build/main/asm/main/main/func_8005E2E4.s.o(.bss);
        build/main/asm/main/main/func_8005E544.s.o(.bss);
        build/main/asm/main/main/func_8005E5A4.s.o(.bss);
        build/main/asm/main/main/func_8005E8B4.s.o(.bss);
        build/main/asm/main/main/func_8005F530.s.o(.bss);
        build/main/asm/main/main/func_8005F5B0.s.o(.bss);
        build/main/asm/main/main/func_8005F6B8.s.o(.bss);
        build/main/asm/main/main/func_8005F838.s.o(.bss);
        build/main/asm/main/main/func_8005F980.s.o(.bss);
        build/main/asm/main/main/func_8005FC3C.s.o(.bss);
        build/main/asm/main/main/func_8005FCC0.s.o(.bss);
        build/main/asm/main/main/func_8005FF44.s.o(.bss);
        build/main/asm/main/main/func_800600D8.s.o(.bss);
        build/main/asm/main/main/func_800602A0.s.o(.bss);
        build/main/asm/main/main/func_80060834.s.o(.bss);
        build/main/asm/main/main/func_80060960.s.o(.bss);
        build/main/asm/main/main/func_80060B9C.s.o(.bss);
        build/main/asm/main/main/func_80060DD8.s.o(.bss);
        build/main/asm/main/main/func_8006114C.s.o(.bss);
        build/main/asm/main/main/func_80061800.s.o(.bss);
        build/main/asm/main/main/func_80061894.s.o(.bss);
        build/main/asm/main/main/func_80061C70.s.o(.bss);
        build/main/asm/main/main/func_80061CF0.s.o(.bss);
        build/main/asm/main/main/func_80061EA4.s.o(.bss);
        build/main/asm/main/main/func_80061EC8.s.o(.bss);
        build/main/asm/main/main/func_80061EE8.s.o(.bss);
        build/main/asm/main/main/func_80061F0C.s.o(.bss);
        build/main/asm/main/main/func_80061FB4.s.o(.bss);
        build/main/asm/main/main/func_800621C0.s.o(.bss);
        build/main/asm/main/main/func_800625C8.s.o(.bss);
        build/main/asm/main/main/func_80062878.s.o(.bss);
        build/main/asm/main/main/func_80062B0C.s.o(.bss);
        build/main/asm/main/main/func_80062CE8.s.o(.bss);
        build/main/asm/main/main/func_80062D98.s.o(.bss);
        build/main/asm/main/main/func_80063158.s.o(.bss);
        build/main/asm/main/main/func_800634DC.s.o(.bss);
        build/main/asm/main/main/func_80063650.s.o(.bss);
        build/main/asm/main/main/func_80063A3C.s.o(.bss);
        build/main/asm/main/main/func_80063B14.s.o(.bss);
        build/main/asm/main/main/func_80063B9C.s.o(.bss);
        build/main/asm/main/main/func_80063C08.s.o(.bss);
        build/main/asm/main/main/func_80063CD8.s.o(.bss);
        build/main/asm/main/main/func_80063DF0.s.o(.bss);
        build/main/asm/main/main/func_80063F7C.s.o(.bss);
        build/main/asm/main/main/func_8006421C.s.o(.bss);
        build/main/asm/main/main/func_80065224.s.o(.bss);
        build/main/asm/main/main/func_80065274.s.o(.bss);
        build/main/asm/main/main/func_800652D8.s.o(.bss);
        build/main/asm/main/main/func_80065370.s.o(.bss);
        build/main/asm/main/main/func_80065424.s.o(.bss);
        build/main/asm/main/main/func_80065560.s.o(.bss);
        build/main/asm/main/main/func_80065648.s.o(.bss);
        build/main/asm/main/main/func_8006584C.s.o(.bss);
        build/main/asm/main/main/func_80065964.s.o(.bss);
        build/main/asm/main/main/func_80065BDC.s.o(.bss);
        build/main/asm/main/main/func_800661AC.s.o(.bss);
        build/main/asm/main/main/func_80066400.s.o(.bss);
        build/main/asm/main/main/func_80066580.s.o(.bss);
        build/main/asm/main/main/func_80066C44.s.o(.bss);
        build/main/asm/main/main/func_800676DC.s.o(.bss);
        build/main/asm/main/main/func_80067DB4.s.o(.bss);
        build/main/asm/main/main/func_80068D2C.s.o(.bss);
        build/main/asm/main/main/func_800693BC.s.o(.bss);
        build/main/asm/main/main/func_80069A60.s.o(.bss);
        build/main/asm/main/main/func_8006AE78.s.o(.bss);
        build/main/asm/main/main/func_8006C128.s.o(.bss);
        build/main/asm/main/main/func_8006CD8C.s.o(.bss);
        build/main/asm/main/main/func_8006CE9C.s.o(.bss);
        build/main/asm/main/main/func_8006CF98.s.o(.bss);
        build/main/asm/main/main/func_8006D1FC.s.o(.bss);
        build/main/asm/main/main/func_800701C8.s.o(.bss);
        build/main/asm/main/main/func_80070454.s.o(.bss);
        build/main/asm/main/main/func_800705F0.s.o(.bss);
        build/main/asm/main/main/func_800707B0.s.o(.bss);
        build/main/asm/main/main/func_80070B0C.s.o(.bss);
        build/main/asm/main/main/func_80070B24.s.o(.bss);
        build/main/asm/main/main/func_80070BCC.s.o(.bss);
        build/main/asm/main/main/func_80070C3C.s.o(.bss);
        build/main/asm/main/main/func_80070C88.s.o(.bss);
        build/main/asm/main/main/func_80070CD4.s.o(.bss);
        build/main/asm/main/main/func_80070D50.s.o(.bss);
        build/main/asm/main/main/func_80070DC4.s.o(.bss);
        build/main/asm/main/main/func_80070E40.s.o(.bss);
        build/main/asm/main/main/func_80070F50.s.o(.bss);
        build/main/asm/main/main/func_80071108.s.o(.bss);
        build/main/asm/main/main/func_80071360.s.o(.bss);
        build/main/asm/main/main/func_80071408.s.o(.bss);
        build/main/asm/main/main/func_800716E4.s.o(.bss);
        build/main/asm/main/main/func_80071A28.s.o(.bss);
        build/main/asm/main/main/func_80071D04.s.o(.bss);
        build/main/asm/main/main/func_80071EA4.s.o(.bss);
        build/main/asm/main/main/func_800721A8.s.o(.bss);
        build/main/asm/main/main/func_80072340.s.o(.bss);
        build/main/asm/main/main/func_80072550.s.o(.bss);
        build/main/asm/main/main/func_800727EC.s.o(.bss);
        build/main/asm/main/main/func_80072AD4.s.o(.bss);
        build/main/asm/main/main/func_80072E00.s.o(.bss);
        build/main/asm/main/main/func_80073480.s.o(.bss);
        build/main/asm/main/main/func_80074E30.s.o(.bss);
        build/main/asm/main/main/func_80074E6C.s.o(.bss);
        build/main/asm/main/main/func_80074EA0.s.o(.bss);
        build/main/asm/main/main/func_80074ED8.s.o(.bss);
        build/main/asm/main/main/func_80074FC4.s.o(.bss);
        build/main/asm/main/main/func_80075004.s.o(.bss);
        build/main/asm/main/main/func_80075044.s.o(.bss);
        build/main/asm/main/main/func_8007515C.s.o(.bss);
        build/main/asm/main/main/func_80075270.s.o(.bss);
        build/main/asm/main/main/func_800752E8.s.o(.bss);
        build/main/asm/main/main/func_80075360.s.o(.bss);
        build/main/asm/main/main/func_8007544C.s.o(.bss);
        build/main/asm/main/main/func_80075518.s.o(.bss);
        build/main/asm/main/main/func_8007558C.s.o(.bss);
        build/main/asm/main/main/func_8007573C.s.o(.bss);
        build/main/asm/main/main/func_8007583C.s.o(.bss);
        build/main/asm/main/main/func_80075908.s.o(.bss);
        build/main/asm/main/main/func_80075B78.s.o(.bss);
        build/main/asm/main/main/func_80075C30.s.o(.bss);
        build/main/asm/main/main/func_80075C7C.s.o(.bss);
        build/main/asm/main/main/func_80075D0C.s.o(.bss);
        build/main/asm/main/main/func_80075D9C.s.o(.bss);
        build/main/asm/main/main/func_80075E04.s.o(.bss);
        build/main/asm/main/main/func_80075EC8.s.o(.bss);
        build/main/asm/main/main/func_80075F90.s.o(.bss);
        build/main/asm/main/main/func_80076344.s.o(.bss);
        build/main/asm/main/main/func_80079F28.s.o(.bss);
        build/main/asm/main/main/func_80079F58.s.o(.bss);
        build/main/asm/main/main/func_8007A210.s.o(.bss);
        build/main/asm/main/main/func_8007A298.s.o(.bss);
        build/main/asm/main/main/func_8007A6D8.s.o(.bss);
        build/main/src/main/main/func_8007A8E0.c.o(.bss);
        build/main/asm/main/main/func_8007A918.s.o(.bss);
        build/main/asm/main/main/func_8007AA68.s.o(.bss);
        build/main/asm/main/main/func_8007ABD8.s.o(.bss);
        build/main/src/main/main/func_8007AC38.c.o(.bss);
        build/main/asm/main/main/func_8007AC98.s.o(.bss);
        build/main/asm/main/main/func_8007AD28.s.o(.bss);
        build/main/asm/main/main/func_8007AE7C.s.o(.bss);
        build/main/asm/main/main/func_8007AEE8.s.o(.bss);
        build/main/asm/main/main/func_8007B118.s.o(.bss);
        build/main/asm/main/main/func_8007B178.s.o(.bss);
        build/main/asm/main/main/func_8007B318.s.o(.bss);
        build/main/asm/main/main/func_8007B380.s.o(.bss);
        build/main/asm/main/main/func_8007B4C0.s.o(.bss);
        build/main/asm/main/main/func_8007B508.s.o(.bss);
        build/main/asm/main/main/func_8007B568.s.o(.bss);
        build/main/src/main/main/func_8007B7D8.c.o(.bss);
        build/main/asm/main/main/func_8007B820.s.o(.bss);
        build/main/asm/main/main/func_8007B890.s.o(.bss);
        build/main/asm/main/main/func_8007BA28.s.o(.bss);
        build/main/asm/main/main/func_8007BD08_merged.s.o(.bss);
        build/main/asm/main/main/func_8007C848.s.o(.bss);
        build/main/asm/main/main/func_8007C948.s.o(.bss);
        build/main/asm/main/main/func_8007C9E8.s.o(.bss);
        build/main/asm/main/main/func_8007CD08.s.o(.bss);
        build/main/asm/main/main/func_8007CE48.s.o(.bss);
        build/main/asm/main/main/func_8007CF98.s.o(.bss);
        build/main/asm/main/main/func_8007D008.s.o(.bss);
        build/main/asm/main/main/func_8007D0E8.s.o(.bss);
        build/main/asm/main/main/func_8007D240.s.o(.bss);
        build/main/asm/main/main/func_8007D30C.s.o(.bss);
        build/main/asm/main/main/func_8007D47C.s.o(.bss);
        build/main/asm/main/main/func_8007D4F0.s.o(.bss);
        build/main/asm/main/main/func_8007D688.s.o(.bss);
        build/main/asm/main/main/func_8007D8CC.s.o(.bss);
        build/main/asm/main/main/func_8007DA74.s.o(.bss);
        build/main/asm/main/main/func_8007DAB0.s.o(.bss);
        build/main/asm/main/main/func_8007DD1C.s.o(.bss);
        build/main/asm/main/main/func_8007DD7C.s.o(.bss);
        build/main/asm/main/main/func_8007E074.s.o(.bss);
        build/main/asm/main/main/func_8007E188.s.o(.bss);
        build/main/src/main/main/func_8007E5E8.c.o(.bss);
        build/main/asm/main/main/func_8007E618.s.o(.bss);
        build/main/asm/main/main/func_8007E6C4.s.o(.bss);
        build/main/asm/main/main/func_8007E734.s.o(.bss);
        build/main/asm/main/main/func_8007E858.s.o(.bss);
        build/main/asm/main/main/func_8007E8E4.s.o(.bss);
        build/main/asm/main/main/func_8007E9D8.s.o(.bss);
        build/main/asm/main/main/func_8007EA18.s.o(.bss);
        build/main/asm/main/main/func_8007EA68.s.o(.bss);
        build/main/asm/main/main/func_8007EAA8.s.o(.bss);
        build/main/src/main/main/func_8007EAE8.c.o(.bss);
        build/main/asm/main/main/func_8007EB18.s.o(.bss);
        build/main/asm/main/main/func_8007EBC4.s.o(.bss);
        build/main/asm/main/main/func_8007ED94.s.o(.bss);
        build/main/asm/main/main/func_8007F5C4.s.o(.bss);
        build/main/asm/main/main/func_8007FBD8.s.o(.bss);
        build/main/asm/main/main/func_8007FE7C.s.o(.bss);
        build/main/asm/main/main/func_8007FFE4.s.o(.bss);
        build/main/asm/main/main/func_80080110.s.o(.bss);
        build/main/asm/main/main/func_80080228.s.o(.bss);
        build/main/asm/main/main/func_800805A4.s.o(.bss);
        build/main/asm/main/main/func_80080DC4.s.o(.bss);
        build/main/asm/main/main/func_800813E8.s.o(.bss);
        build/main/asm/main/main/func_800814EC.s.o(.bss);
        build/main/asm/main/main/func_8008155C.s.o(.bss);
        build/main/asm/main/main/func_8008177C.s.o(.bss);
        build/main/asm/main/main/func_80081900.s.o(.bss);
        build/main/asm/main/main/func_80081B58.s.o(.bss);
        build/main/asm/main/main/func_80081C30.s.o(.bss);
        build/main/asm/main/main/func_80081D08.s.o(.bss);
        build/main/asm/main/main/func_80081D94.s.o(.bss);
        build/main/asm/main/main/func_800822DC.s.o(.bss);
        build/main/asm/main/main/func_80082528.s.o(.bss);
        build/main/asm/main/main/func_80082598.s.o(.bss);
        build/main/asm/main/main/func_80082608.s.o(.bss);
        build/main/asm/main/main/func_80082698.s.o(.bss);
        build/main/asm/main/main/func_800826F8.s.o(.bss);
        build/main/asm/main/main/func_80082758.s.o(.bss);
        build/main/src/main/main/func_80082818.c.o(.bss);
        build/main/asm/main/main/func_80082850.s.o(.bss);
        build/main/asm/main/main/func_80082900.s.o(.bss);
        build/main/asm/main/main/func_80082B98.s.o(.bss);
        build/main/src/main/main/func_80082E98.c.o(.bss);
        build/main/src/main/main/func_80082EDC.c.o(.bss);
        build/main/src/main/main/func_80082F30.c.o(.bss);
        build/main/asm/main/main/func_80082F84.s.o(.bss);
        build/main/asm/main/main/func_8008300C.s.o(.bss);
        build/main/asm/main/main/func_800830B4.s.o(.bss);
        build/main/asm/main/main/func_800831F8.s.o(.bss);
        build/main/asm/main/main/func_80083638.s.o(.bss);
        build/main/asm/main/main/func_8008380C.s.o(.bss);
        build/main/asm/main/main/func_80083BB8.s.o(.bss);
        build/main/asm/main/main/func_80083CE4.s.o(.bss);
        build/main/asm/main/main/func_800841B8.s.o(.bss);
        build/main/src/main/main/func_800843AC.c.o(.bss);
        build/main/asm/main/main/func_8008448C.s.o(.bss);
        build/main/asm/main/main/func_8008465C.s.o(.bss);
        build/main/asm/main/main/func_800849A4.s.o(.bss);
        build/main/asm/main/main/func_80084F48.s.o(.bss);
        build/main/asm/main/main/func_8008506C.s.o(.bss);
        build/main/asm/main/main/func_80085154.s.o(.bss);
        build/main/asm/main/main/func_80085410.s.o(.bss);
        build/main/asm/main/main/func_800854C8.s.o(.bss);
        build/main/asm/main/main/func_80085650.s.o(.bss);
        build/main/asm/main/main/func_800857DC.s.o(.bss);
        build/main/asm/main/main/func_80085A04.s.o(.bss);
        build/main/asm/main/main/func_80085C74.s.o(.bss);
        build/main/asm/main/main/func_80085FEC.s.o(.bss);
        build/main/asm/main/main/func_80086088.s.o(.bss);
        build/main/asm/main/main/func_800860D8.s.o(.bss);
        build/main/asm/main/main/func_80086188.s.o(.bss);
        build/main/asm/main/main/func_80086208.s.o(.bss);
        build/main/asm/main/main/func_80086298.s.o(.bss);
        build/main/asm/main/main/func_80086388.s.o(.bss);
        build/main/asm/main/main/func_80086418.s.o(.bss);
        build/main/asm/main/main/func_800864B8.s.o(.bss);
        build/main/asm/main/main/func_80086558.s.o(.bss);
        build/main/asm/main/main/func_800865F8.s.o(.bss);
        build/main/asm/main/main/func_800866F4.s.o(.bss);
        build/main/asm/main/main/func_80086848.s.o(.bss);
        build/main/asm/main/main/func_80086904.s.o(.bss);
        build/main/asm/main/main/func_80086928.s.o(.bss);
        build/main/asm/main/main/func_80086A44.s.o(.bss);
        build/main/asm/main/main/func_80086BD4.s.o(.bss);
        build/main/asm/main/main/func_80086C20.s.o(.bss);
        build/main/asm/main/main/func_80086C60.s.o(.bss);
        build/main/asm/main/main/func_80086C98.s.o(.bss);
        build/main/src/main/main/func_80086D28.c.o(.bss);
        build/main/asm/main/main/func_80086D48.s.o(.bss);
        build/main/asm/main/main/func_80086DE0.s.o(.bss);
        build/main/asm/main/main/func_80086F60.s.o(.bss);
        build/main/asm/main/main/func_80087158.s.o(.bss);
        build/main/asm/main/main/func_800872A8.s.o(.bss);
        build/main/asm/main/main/func_80087318.s.o(.bss);
        build/main/asm/main/main/func_80087388.s.o(.bss);
        build/main/asm/main/main/func_80087548.s.o(.bss);
        build/main/asm/main/main/func_80087678.s.o(.bss);
        build/main/asm/main/main/func_800876D8.s.o(.bss);
        build/main/asm/main/main/func_80087728.s.o(.bss);
        build/main/asm/main/main/func_80087A88.s.o(.bss);
        build/main/asm/main/main/func_80087AF8.s.o(.bss);
        build/main/asm/main/main/func_80087B50.s.o(.bss);
        build/main/asm/main/main/func_80087B78.s.o(.bss);
        build/main/asm/main/main/func_80087BC8.s.o(.bss);
        build/main/asm/main/main/func_80087C4C.s.o(.bss);
        build/main/asm/main/main/func_80087C78.s.o(.bss);
        build/main/src/main/main/func_80087D28.c.o(.bss);
        build/main/asm/main/main/func_80087D78.s.o(.bss);
        build/main/asm/main/main/func_80087D80.s.o(.bss);
        build/main/src/main/main/func_80087DBC.c.o(.bss);
        build/main/asm/main/main/func_80087DE8.s.o(.bss);
        build/main/asm/main/main/func_80087EB8.s.o(.bss);
        build/main/asm/main/main/func_80087F54.s.o(.bss);
        build/main/asm/main/main/func_80088048.s.o(.bss);
        build/main/asm/main/main/func_80088248.s.o(.bss);
        build/main/asm/main/main/func_80088310.s.o(.bss);
        build/main/asm/main/main/func_80088408.s.o(.bss);
        build/main/asm/main/main/func_800884E8.s.o(.bss);
        build/main/asm/main/main/func_8008896C.s.o(.bss);
        build/main/asm/main/main/func_80088BD0.s.o(.bss);
        build/main/asm/main/main/func_80088C98.s.o(.bss);
        build/main/asm/main/main/func_80088E9C.s.o(.bss);
        build/main/asm/main/main/func_80089018.s.o(.bss);
        build/main/asm/main/main/func_800890C8.s.o(.bss);
        build/main/asm/main/main/func_80089198.s.o(.bss);
        build/main/asm/main/main/func_800891F4.s.o(.bss);
        build/main/asm/main/main/func_8008925C.s.o(.bss);
        build/main/asm/main/main/func_80089674.s.o(.bss);
        build/main/asm/main/main/func_8008980C.s.o(.bss);
        build/main/asm/main/main/func_80089A68.s.o(.bss);
        build/main/asm/main/main/func_80089B64.s.o(.bss);
        build/main/asm/main/main/func_80089E84.s.o(.bss);
        build/main/asm/main/main/func_80089EF8.s.o(.bss);
        build/main/asm/main/main/func_8008A114.s.o(.bss);
        build/main/asm/main/main/func_8008A288.s.o(.bss);
        build/main/asm/main/main/func_8008A568.s.o(.bss);
        build/main/asm/main/main/func_8008A7A0.s.o(.bss);
        build/main/asm/main/main/func_8008A898.s.o(.bss);
        build/main/asm/main/main/func_8008A994.s.o(.bss);
        build/main/asm/main/main/func_8008AD98.s.o(.bss);
        build/main/asm/main/main/func_8008B088.s.o(.bss);
        build/main/asm/main/main/func_8008B248.s.o(.bss);
        build/main/asm/main/main/func_8008B3E8.s.o(.bss);
        build/main/asm/main/main/func_8008B4EC.s.o(.bss);
        build/main/asm/main/main/func_8008B5B8.s.o(.bss);
        build/main/asm/main/main/func_8008B708.s.o(.bss);
        build/main/asm/main/main/func_8008B858.s.o(.bss);
        build/main/asm/main/main/func_8008BAC8.s.o(.bss);
        build/main/asm/main/main/func_8008C18C.s.o(.bss);
        build/main/asm/main/main/func_8008C340.s.o(.bss);
        build/main/asm/main/main/func_8008C528.s.o(.bss);
        build/main/asm/main/main/func_8008C788.s.o(.bss);
        build/main/asm/main/main/func_8008C898.s.o(.bss);
        build/main/asm/main/main/func_8008CA00.s.o(.bss);
        build/main/asm/main/main/func_8008CB6C.s.o(.bss);
        build/main/asm/main/main/func_8008CCE8.s.o(.bss);
        build/main/asm/main/main/func_8008CEC0.s.o(.bss);
        build/main/asm/main/main/func_8008CF18.s.o(.bss);
        build/main/asm/main/main/func_8008D0A8.s.o(.bss);
        build/main/asm/main/main/func_8008D188.s.o(.bss);
        build/main/asm/main/main/func_8008D3C0.s.o(.bss);
        build/main/asm/main/main/func_8008D4EC.s.o(.bss);
        build/main/asm/main/main/func_8008D5B0.s.o(.bss);
        build/main/asm/main/main/func_8008DC54.s.o(.bss);
        build/main/asm/main/main/func_8008DD34.s.o(.bss);
        build/main/asm/main/main/func_8008DE28.s.o(.bss);
        build/main/asm/main/main/func_8008E2B8.s.o(.bss);
        build/main/asm/main/main/func_8008E318.s.o(.bss);
        build/main/asm/main/main/func_8008E368.s.o(.bss);
        build/main/asm/main/main/func_8008E3C0.s.o(.bss);
        build/main/asm/main/main/func_8008E410.s.o(.bss);
        build/main/src/main/main/func_8008E458.c.o(.bss);
        build/main/asm/main/main/func_8008E4A8.s.o(.bss);
        build/main/asm/main/main/func_8008E4B0.s.o(.bss);
        build/main/src/main/main/func_8008E4EC.c.o(.bss);
        build/main/asm/main/main/func_8008E518.s.o(.bss);
        build/main/asm/main/main/func_8008E628.s.o(.bss);
        build/main/asm/main/main/func_8008ED50.s.o(.bss);
        build/main/src/main/main/func_8008EE18.c.o(.bss);
        build/main/asm/main/main/func_8008EE3C.s.o(.bss);
        build/main/asm/main/main/func_8008EF38.s.o(.bss);
        build/main/asm/main/main/func_8008F5A8.s.o(.bss);
        build/main/asm/main/main/func_8008FBF8.s.o(.bss);
        build/main/asm/main/main/func_8008FE98.s.o(.bss);
        build/main/asm/main/main/func_8008FFA0.s.o(.bss);
        build/main/asm/main/main/func_80090028.s.o(.bss);
        build/main/asm/main/main/func_80090598.s.o(.bss);
        build/main/asm/main/main/func_80090AE8.s.o(.bss);
        build/main/asm/main/main/func_80090C38.s.o(.bss);
        . = ALIGN(., 4);
        main_BSS_END = .;
        main_BSS_SIZE = ABSOLUTE(main_BSS_END - main_BSS_START);
    }
    __romPos += SIZEOF(.main);
    __romPos = ALIGN(__romPos, 16);
    . = ALIGN(., 16);
    main_ROM_END = __romPos;
    main_VRAM_END = .;

    INCLUDE xg2_main.syms.ld

    /DISCARD/ :
    {
        *(*);
    }
}
